## Kconfig
```kconfig
# Copyright (c) 2026 Golioth, Inc.
#
# SPDX-License-Identifier: Apache-2.0

# Add SDK configuration
rsource "golioth_sdk/Kconfig"
```

## boards/bsim_2G4_phy/board.yml
```yaml
boards:
- name: bsim_2G4_phy
  full_name: BabbleSim 2.4 GHz Physical Layer
  vendor: zephyr
  socs:
  - name: native
```

## boards/bsim_device/board.yml
```yaml
boards:
  - name: bsim_device
    full_name: BabbleSim Arbitrary Device
    vendor: zephyr
    socs:
      - name: native
        variants:
          - name: empty
          - name: handbrake
          - name: pause_simu
          - name: time_monitor
```

## boards/native/nrf_bsim/board.yml
```yaml
board:
  extend: nrf52_bsim
  variants:
    - name: bsim
      qualifier: native
```

## dts/bindings/golioth,pouch-broker-spi.yaml
```yaml
# Copyright (c) 2026 Golioth, Inc.
# SPDX-License-Identifier: Apache-2.0

title: Pouch SPI Broker transport adapter

description: |
  This node should be a child of an SPI bus controller. The broker acts as SPI
  master, exchanging frames with a device (SPI slave). Multiple instances may
  exist on the same SPI bus.

compatible: "golioth,pouch-broker"

include: spi-device.yaml

properties:
  data-ready-gpios:
    type: phandle-array
    description: |
      Optional GPIO input pin connected to the device's data-ready output.
      When defined, the broker uses an interrupt on the rising edge to detect
      when the device has data available. When omitted, the broker polls at
      the interval specified by poll-interval-ms.

  poll-interval-ms:
    type: int
    default: 1000
    description: |
      Polling interval in milliseconds. Only used when data-ready-gpios is
      not defined. The broker polls the device at this interval to check for
      data.
```

## dts/bindings/golioth,pouch-broker-uart.yaml
```yaml
# Copyright (c) 2026 Golioth, Inc.
# SPDX-License-Identifier: Apache-2.0

title: Pouch UART Broker transport adapter

description: |
  Declares a Pouch serial broker that exchanges frames with a device over a
  point-to-point UART link. The broker runs on the gateway and drives the
  exchange sequence. The node is instantiated on a UART bus.

  Example overlay:

    &uart1 {
        status = "okay";
        current-speed = <115200>;

        pouch_uart_broker: pouch-uart-broker {
            compatible = "golioth,pouch-broker";
        };
    };

compatible: "golioth,pouch-broker"

include: uart-device.yaml
```

## dts/bindings/golioth,pouch-device-spi.yaml
```yaml
# Copyright (c) 2026 Golioth, Inc.
# SPDX-License-Identifier: Apache-2.0

title: Pouch SPI Device transport adapter

description: |
  This node should be a child of an SPI bus controller. The device acts as an
  SPI slave, exchanging frames with a broker (SPI master).

compatible: "golioth,pouch-device"

include: spi-device.yaml

properties:
  data-ready-gpios:
    type: phandle-array
    description: |
      Optional GPIO pin asserted when the device has data to send.
      If omitted, the master must poll periodically.
```

## dts/bindings/golioth,pouch-device-uart.yaml
```yaml
# Copyright (c) 2026 Golioth, Inc.
# SPDX-License-Identifier: Apache-2.0

title: Pouch UART Device transport adapter

description: |
  Declares a Pouch serial device that exchanges frames with a broker over a
  point-to-point UART link.

compatible: "golioth,pouch-device"

include: uart-device.yaml
```

## examples/esp_idf/ble_gatt/main/Kconfig.projbuild
```kconfig
# Copyright (c) 2026 Golioth, Inc.
#
# SPDX-License-Identifier: Apache-2.0

config EXAMPLE_BT_DEVICE_NAME
    string "Device name to use when advertising"
    default "Golioth"
    help
      Name that will be advertised to other Bluetooth devices.

config EXAMPLE_SYNC_PERIOD_S
    int "Sync Period (s)"
    default 20
    help
      The time, in seconds, after a sync to wait before requesting a
      sync from a gateway.

config EXAMPLE_FW_UPDATE_COMPONENT
    string "OTA component to use for firmware update"
    default "ble_gatt_example"
    help
      Name of component in OTA manifest to use for firmware update.
```

## examples/esp_idf/ble_gatt/sdkconfig.defaults
```kconfig
CONFIG_ESP_MAIN_TASK_STACK_SIZE=4608
CONFIG_LOG_TIMESTAMP_SOURCE_SYSTEM=y

# Pouch
CONFIG_POUCH=y
CONFIG_POUCH_ENCRYPTION_SAEAD=y
CONFIG_POUCH_ENCRYPTION_CHACHA20_POLY1305=y
CONFIG_POUCH_TRANSPORT_BLE_GATT=y
CONFIG_POUCH_TRANSPORT_GATT_WINDOW_SIZE=3
CONFIG_POUCH_TRANSPORT_GATT_MTU_SIZE=517
CONFIG_POUCH_CA_CERT_FILENAME="src/goliothrootx1.der"
CONFIG_POUCH_THREAD_STACK_SIZE=4096
CONFIG_POUCH_BLOCK_COUNT=4

# Golioth SDK
CONFIG_GOLIOTH=y
CONFIG_GOLIOTH_SETTINGS=y
CONFIG_GOLIOTH_OTA=y

# mbedTLS / PSA Crypto
CONFIG_MBEDTLS_PSA_CRYPTO_C=y

# Bluetooth (NimBLE)
CONFIG_BT_ENABLED=y
CONFIG_BT_NIMBLE_ENABLED=y
CONFIG_BT_NIMBLE_SM_SC=y
CONFIG_BT_NIMBLE_NVS_PERSIST=n
CONFIG_BT_NIMBLE_HOST_TASK_STACK_SIZE=16384
CONFIG_BT_NIMBLE_LOG_LEVEL_WARNING=y

# Target
CONFIG_IDF_TARGET="esp32s3"

# Partition table (two OTA slots required for firmware update)
CONFIG_PARTITION_TABLE_TWO_OTA=y

# Flash size (8MB to accommodate two OTA partitions)
CONFIG_ESPTOOLPY_FLASHSIZE_8MB=y

# Application Version
CONFIG_APP_PROJECT_VER_FROM_CONFIG=y
CONFIG_APP_PROJECT_VER="1.0.0"
```

## examples/esp_idf/http_client/sdkconfig.defaults
```kconfig
CONFIG_ESP_MAIN_TASK_STACK_SIZE=5500
CONFIG_POUCH_THREAD_STACK_SIZE=3328
CONFIG_POUCH_UPLINK_PROCESSING_STACK_SIZE=1792
CONFIG_LOG_TIMESTAMP_SOURCE_SYSTEM=y

# Pouch
CONFIG_POUCH=y
CONFIG_POUCH_TRANSPORT_HTTP_CLIENT=y
CONFIG_GOLIOTH=y
CONFIG_GOLIOTH_OTA=y
CONFIG_GOLIOTH_SETTINGS=y

# Flash size
CONFIG_PARTITION_TABLE_TWO_OTA_LARGE=y
CONFIG_ESPTOOLPY_FLASHSIZE_8MB=y

# Application Version
CONFIG_APP_PROJECT_VER_FROM_CONFIG=y
CONFIG_APP_PROJECT_VER="1.0.0"
```

## examples/esp_idf/serial_device/main/Kconfig.projbuild
```kconfig
# Copyright (c) 2026 Golioth, Inc.
#
# SPDX-License-Identifier: Apache-2.0

menu "Example: Pouch UART Serial Device"

config EXAMPLE_SYNC_PERIOD_S
    int "Sync Period (s)"
    default 20
    help
      The time, in seconds, after a sync to wait before requesting a
      sync from a gateway.

config EXAMPLE_FW_UPDATE_COMPONENT
    string "OTA component to use for firmware update"
    default "serial_device_example"
    help
      Name of component in OTA manifest to use for firmware update.

endmenu
```

## examples/esp_idf/serial_device/sdkconfig.defaults
```kconfig
CONFIG_ESP_MAIN_TASK_STACK_SIZE=4608
CONFIG_LOG_TIMESTAMP_SOURCE_SYSTEM=y

# Pouch
CONFIG_POUCH=y
CONFIG_POUCH_ENCRYPTION_SAEAD=y
CONFIG_POUCH_ENCRYPTION_CHACHA20_POLY1305=y
CONFIG_POUCH_UART_DEVICE=y
CONFIG_POUCH_UART_BAUD_RATE=115200
CONFIG_POUCH_UART_TX_PIN=17
CONFIG_POUCH_UART_RX_PIN=18
CONFIG_POUCH_THREAD_STACK_SIZE=4096
CONFIG_POUCH_BLOCK_COUNT=4

# Golioth SDK
CONFIG_GOLIOTH=y
CONFIG_GOLIOTH_SETTINGS=y
CONFIG_GOLIOTH_OTA=y

# Target
CONFIG_IDF_TARGET="esp32s3"

# Partition table (two OTA slots required for firmware update)
CONFIG_PARTITION_TABLE_TWO_OTA=y

# Flash size (8MB to accommodate two OTA partitions)
CONFIG_ESPTOOLPY_FLASHSIZE_8MB=y

# Application Version
CONFIG_APP_PROJECT_VER_FROM_CONFIG=y
CONFIG_APP_PROJECT_VER="1.0.0"
```

## examples/gateway_custom_connect/Kconfig
```kconfig
# Copyright (c) 2025 Golioth, Inc.
# SPDX-License-Identifier: Apache-2.0

configdefault NET_SHELL
	default n

configdefault MBEDTLS_USE_PSA_CRYPTO
	default n

configdefault MBEDTLS_HEAP_SIZE
	default 16384

configdefault BT_CTLR_DATA_LENGTH_MAX
	default 251

# This option is used only for automated tests
config SAMPLE_POUCH_GATEWAY_BT_AUTO_BOND
	bool
	default y if BOARD_NRF52_BSIM_NATIVE

# This option is used only for automated tests
config SAMPLE_POUCH_GATEWAY_BT_AUTO_CONFIRM
	bool
	default y if BOARD_NRF52_BSIM_NATIVE

source "${ZEPHYR_GOLIOTH_FIRMWARE_SDK_MODULE_DIR}/examples/zephyr/common/Kconfig.defconfig"

source "Kconfig.zephyr"
```

## examples/gateway_custom_connect/boards/thingy91x_nrf9151_ns.conf
```kconfig
CONFIG_UART_CONSOLE=n
CONFIG_RTT_CONSOLE=y
CONFIG_USE_SEGGER_RTT=y
CONFIG_SHELL_BACKEND_RTT=y
```

## examples/gateway_custom_connect/sample.yaml
```yaml
sample:
  name: Pouch Gateway with custom connect
common:
  tags: bluetooth
  harness: pytest
  harness_config:
    pytest_dut_scope: module
  sysbuild: true
  platform_allow:
    - nrf52_bsim
  integration_platforms:
    - nrf52_bsim
  timeout: 120
tests:
  pouch.gateway_custom_connect.lesc:
    extra_args:
      - SB_CONFIG_PERIPHERAL_MOUNT_CREDS=y
      - peripheral_ble_gatt_example_0_CONFIG_PICOLIBC=y
      - peripheral_ble_gatt_example_0_CONFIG_FILE_SYSTEM_NSIM_MOUNT=y
      - peripheral_ble_gatt_example_0_CONFIG_EXAMPLE_SYNC_PERIOD_S=2
  pouch.gateway_custom_connect.auth:
    extra_args:
      - SB_CONFIG_PERIPHERAL_MOUNT_CREDS=y
      - peripheral_ble_gatt_example_0_CONFIG_PICOLIBC=y
      - peripheral_ble_gatt_example_0_CONFIG_FILE_SYSTEM_NSIM_MOUNT=y
      - peripheral_ble_gatt_example_0_CONFIG_EXAMPLE_SYNC_PERIOD_S=2
      - gateway_custom_connect_CONFIG_POUCH_GATEWAY_GATT_SCAN_FILTER_BONDED=y
```

## examples/ncs-serial-modem/Kconfig
```kconfig
# Copyright (c) 2026 Golioth, Inc.
# SPDX-License-Identifier: Apache-2.0

source "${ZEPHYR_NCS_SERIAL_MODEM_MODULE_DIR}/app/Kconfig"
```

## examples/ncs-serial-modem/Kconfig.sysbuild
```kconfig
# Copyright (c) 2026 Golioth, Inc.
# SPDX-License-Identifier: Apache-2.0

rsource "Kconfig.sysbuild.defconfig"

source "share/sysbuild/Kconfig"
```

## examples/ncs-serial-modem/Kconfig.sysbuild.defconfig
```kconfig
# Copyright (c) 2026 Golioth, Inc.
# SPDX-License-Identifier: Apache-2.0

if BOARD_THINGY91X_NRF9151 || BOARD_THINGY91X_NRF9151_NS

choice THINGY91X_LAYOUT
	prompt "Pre-defined Thingy:91 X partition layout"
	default THINGY91X_NO_PREDEFINED_LAYOUT

config THINGY91X_NO_PREDEFINED_LAYOUT
	bool "None [EXPERIMENTAL]"
endchoice

config PM_EXTERNAL_FLASH_MCUBOOT_SECONDARY
	default n

config PM_OVERRIDE_EXTERNAL_DRIVER_CHECK
	default n

endif # BOARD_THINGY91X_NRF9151 || BOARD_THINGY91X_NRF9151_NS
```

## examples/zephyr/ncs-serial-modem/boards/thingy91x_nrf9151_ns.conf
```kconfig
# Route console and logs to RTT so the nRF9151's two UARTs are free for the
# inter-chip serial-modem link (UART0/UART1 data + flow control pins).
CONFIG_UART_CONSOLE=n
CONFIG_LOG_BACKEND_UART=n
CONFIG_RTT_CONSOLE=y
CONFIG_LOG_BACKEND_RTT=y
CONFIG_USE_SEGGER_RTT=y
```

## examples/zephyr/ncs-serial-modem/sysbuild/mcuboot/boards/thingy91x_nrf9151.conf
```kconfig
#
# Copyright (c) 2026 Golioth, Inc.
#
# SPDX-License-Identifier: Apache-2.0
#

# Disable Zephyr console
CONFIG_CONSOLE=n
CONFIG_CONSOLE_HANDLER=n
CONFIG_UART_CONSOLE=n
```

## examples/zephyr/ncs-serial-modem/west.yml
```yaml
manifest:
  projects:
    - name: ncs-serial-modem
      path: ncs-serial-modem
      revision: v1.0.0
      url: https://github.com/nrfconnect/ncs-serial-modem.git
      import: true

  self:
    path: pouch
    west-commands: scripts/west-commands.yml
```

## golioth_sdk/Kconfig
```kconfig
# Copyright (c) 2025 Golioth, Inc.
#
# SPDX-License-Identifier: Apache-2.0

menuconfig GOLIOTH
  bool "Golioth SDK"
  depends on POUCH

if GOLIOTH

menuconfig GOLIOTH_SETTINGS
  bool "Golioth Settings service"
  select ZCBOR_UTILS
  help
    Enables the Golioth Settings service. This allows for syncing
    configuration data from the Golioth service down to the device.

if GOLIOTH_SETTINGS

choice GOLIOTH_SETTINGS_FRONTEND
  prompt "Settings frontend"
  help
    Choose how applications interact with the Settings service

config GOLIOTH_SETTINGS_FRONTEND_CALLBACKS
  bool "Callbacks"
  help
    This enables a callback-based frontend to the Settings service.
    Applications can register callbacks for individual settings values
    at runtime.

endchoice

endif

menuconfig GOLIOTH_OTA
  bool "Golioth OTA service"
  help
    Enables the Golioth OTA service. This service is used to sync
    binary artifacts like firmware updates or AI models to the device.

if GOLIOTH_OTA

config GOLIOTH_OTA_MAX_PACKAGE_NAME_LEN
  int "Maximum package name length"
  default 32

config GOLIOTH_OTA_MAX_VERSION_LEN
  int "Maximum package version length"
  default 32

endif

endif
```
