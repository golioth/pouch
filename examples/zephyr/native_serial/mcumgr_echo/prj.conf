## CMakeLists.txt
```
# Copyright (c) 2026 Golioth, Inc.
# SPDX-License-Identifier: Apache-2.0

cmake_minimum_required(VERSION 3.20.0)

# Register the native_parallel runner before Zephyr processes board.cmake.
set(BOARD_FLASH_RUNNER native_parallel)
macro(app_set_runner_args)
  get_property(_np_done GLOBAL PROPERTY _NATIVE_PARALLEL_RUNNER_FINALIZED)
  if(NOT _np_done)
    set_property(GLOBAL PROPERTY _NATIVE_PARALLEL_RUNNER_FINALIZED TRUE)
    board_finalize_runner_args(native_parallel)
  endif()
endmacro()

find_package(Zephyr REQUIRED HINTS $ENV{ZEPHYR_BASE})
project(mcumgr_echo_server)

target_sources(app PRIVATE src/main.c)
```

## Kconfig.sysbuild
```
# Copyright (c) 2026 Golioth, Inc.
# SPDX-License-Identifier: Apache-2.0

source "share/sysbuild/Kconfig"
```

## sample.yaml
```
# Copyright (c) 2026 Golioth, Inc.
# SPDX-License-Identifier: Apache-2.0

sample:
  name: MCUmgr Echo over Serial

tests:
  pouch.mcumgr_echo:
    sysbuild: true
    platform_allow:
      - native_sim
    harness: pytest
    tags: mcumgr serial uart smp
```

## prj.conf
```kconfig
# Copyright (c) 2026 Golioth, Inc.
# SPDX-License-Identifier: Apache-2.0

CONFIG_SERIAL=y
CONFIG_UART_NATIVE_PTY_0_ON_STDINOUT=y

# MCUmgr server with OS echo group over UART transport
CONFIG_MCUMGR=y
CONFIG_UART_MCUMGR=y
CONFIG_MCUMGR_TRANSPORT_UART=y
CONFIG_MCUMGR_GRP_OS=y

# Dependencies of MCUMGR
CONFIG_NET_BUF=y
CONFIG_ZCBOR=y
CONFIG_BASE64=y
CONFIG_CRC=y
```

## src/main.c
```c
/*
 * Copyright (c) 2026 Golioth, Inc.
 *
 * SPDX-License-Identifier: Apache-2.0
 */

/**
 * MCUmgr Echo Server
 *
 * The MCUmgr subsystem auto-registers at SYS_INIT time:
 * - SMP UART transport (via CONFIG_MCUMGR_TRANSPORT_UART)
 * - OS management group with echo handler (via CONFIG_MCUMGR_GRP_OS)
 *
 * All this main() needs to do is keep the system alive.
 */

#include <zephyr/kernel.h>

int main(void)
{
    printk("MCUmgr echo server ready\n");
    k_sleep(K_FOREVER);
    return 0;
}
```
