## CMakeLists.txt
```
# Copyright (c) 2026 Golioth, Inc.
# SPDX-License-Identifier: Apache-2.0

cmake_minimum_required(VERSION 3.20.0)

# See cmake/native_parallel.cmake for what this boilerplate does.
set(BOARD_FLASH_RUNNER native_parallel)
set(BOARD_DEBUG_RUNNER native_parallel)
macro(app_set_runner_args)
  get_property(_np_done GLOBAL PROPERTY _NATIVE_PARALLEL_RUNNER_FINALIZED)
  if(NOT _np_done)
    set_property(GLOBAL PROPERTY _NATIVE_PARALLEL_RUNNER_FINALIZED TRUE)
    board_finalize_runner_args(native_parallel)
  endif()
endmacro()

find_package(Zephyr REQUIRED HINTS $ENV{ZEPHYR_BASE})
project(serial_comm_server)

target_sources(app PRIVATE src/main.c)
```

## sample.yaml
```
# Copyright (c) 2026 Golioth, Inc.
# SPDX-License-Identifier: Apache-2.0

sample:
  name: Serial Communication Test

tests:
  pouch.serial_comm:
    sysbuild: true
    platform_allow:
      - native_sim
    harness: pytest
    tags: serial uart
```

## prj.conf
```kconfig
# Copyright (c) 2026 Golioth, Inc.
# SPDX-License-Identifier: Apache-2.0

CONFIG_SERIAL=y
CONFIG_UART_NATIVE_PTY_0_ON_STDINOUT=y
```

## boards/native_sim.overlay
```dts
/*
 * Copyright (c) 2026 Golioth, Inc.
 *
 * SPDX-License-Identifier: Apache-2.0
 */

/* The serial_link_0 label is documentation only -- a hint that this
 * UART is one end of a virtual serial link.  The actual wiring is
 * done by native_parallel_serial_link() in sysbuild.cmake, which
 * matches domains and UART node names rather than labels.
 */
serial_link_0: &uart1 {
	status = "okay";
	compatible = "zephyr,native-tty-uart";
	current-speed = <115200>;
};
```

## src/main.c
```c
/*
 * Copyright (c) 2026 Golioth, Inc.
 *
 * SPDX-License-Identifier: Apache-2.0
 */

#include <zephyr/kernel.h>
#include <zephyr/device.h>
#include <zephyr/drivers/uart.h>

int main(void)
{
    const struct device *uart = DEVICE_DT_GET(DT_NODELABEL(uart1));

    if (!device_is_ready(uart))
    {
        printk("Server: uart1 device not ready\n");
        return -1;
    }

    printk("Server: waiting for data on uart1\n");

    unsigned char buf[128];
    int idx = 0;

    while (1)
    {
        unsigned char c;

        if (uart_poll_in(uart, &c) == 0)
        {
            if (c == '\n' || idx >= (int) (sizeof(buf) - 1))
            {
                buf[idx] = '\0';
                printk("RECEIVED: %s\n", buf);
                idx = 0;
            }
            else
            {
                buf[idx++] = c;
            }
        }

        k_sleep(K_MSEC(1));
    }

    return 0;
}
```
