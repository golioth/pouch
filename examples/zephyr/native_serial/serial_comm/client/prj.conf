## CMakeLists.txt
```
# Copyright (c) 2026 Golioth, Inc.
# SPDX-License-Identifier: Apache-2.0

cmake_minimum_required(VERSION 3.20.0)

# See cmake/native_parallel.cmake for what this boilerplate does.
set(BOARD_FLASH_RUNNER native_parallel)
set(BOARD_DEBUG_RUNNER native_parallel)
macro(app_set_runner_args)
  get_property(_np_done GLOBAL PROPERTY _NATIVE_PARALLEL_RUNNER_FINALIZED)
  if(NOT _np_done)
    set_property(GLOBAL PROPERTY _NATIVE_PARALLEL_RUNNER_FINALIZED TRUE)
    board_finalize_runner_args(native_parallel)
  endif()
endmacro()

find_package(Zephyr REQUIRED HINTS $ENV{ZEPHYR_BASE})
project(serial_comm_client)

target_sources(app PRIVATE src/main.c)
```

## prj.conf
```kconfig
# Copyright (c) 2026 Golioth, Inc.
# SPDX-License-Identifier: Apache-2.0

CONFIG_SERIAL=y
```

## boards/native_sim.overlay
```dts
/*
 * Copyright (c) 2026 Golioth, Inc.
 *
 * SPDX-License-Identifier: Apache-2.0
 */

/* serial_link_0: client end of the virtual serial link; see the
 * server overlay for what the label does (and does not) imply.
 */
serial_link_0: &uart1 {
	status = "okay";
	compatible = "zephyr,native-tty-uart";
	current-speed = <115200>;
};
```

## src/main.c
```c
/*
 * Copyright (c) 2026 Golioth, Inc.
 *
 * SPDX-License-Identifier: Apache-2.0
 */

#include <zephyr/kernel.h>
#include <zephyr/device.h>
#include <zephyr/drivers/uart.h>

int main(void)
{
    const struct device *uart = DEVICE_DT_GET(DT_NODELABEL(uart1));

    if (!device_is_ready(uart))
    {
        printk("Client: uart1 device not ready\n");
        return -1;
    }

    printk("Client: sending data on uart1\n");

    const char *msg = "Hello from client!\n";

    for (int i = 0; msg[i] != '\0'; i++)
    {
        uart_poll_out(uart, msg[i]);
    }

    printk("Client: done sending\n");

    return 0;
}
```
