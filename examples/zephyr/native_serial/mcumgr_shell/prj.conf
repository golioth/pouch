## CMakeLists.txt
```
# Copyright (c) 2026 Golioth, Inc.
# SPDX-License-Identifier: Apache-2.0

cmake_minimum_required(VERSION 3.20.0)

# See cmake/native_parallel.cmake for what this boilerplate does.
set(BOARD_FLASH_RUNNER native_parallel)
macro(app_set_runner_args)
  get_property(_np_done GLOBAL PROPERTY _NATIVE_PARALLEL_RUNNER_FINALIZED)
  if(NOT _np_done)
    set_property(GLOBAL PROPERTY _NATIVE_PARALLEL_RUNNER_FINALIZED TRUE)
    board_finalize_runner_args(native_parallel)
  endif()
endmacro()

find_package(Zephyr REQUIRED HINTS $ENV{ZEPHYR_BASE})
project(mcumgr_shell_server)

target_sources(app PRIVATE src/main.c)
```

## sample.yaml
```
# Copyright (c) 2026 Golioth, Inc.
# SPDX-License-Identifier: Apache-2.0

sample:
  name: MCUmgr Remote Shell over Serial

tests:
  pouch.mcumgr_shell:
    sysbuild: true
    platform_allow:
      - native_sim
    harness: pytest
    tags: mcumgr serial uart smp shell
```

## prj.conf
```kconfig
# Copyright (c) 2026 Golioth, Inc.
# SPDX-License-Identifier: Apache-2.0

CONFIG_SERIAL=y
CONFIG_UART_NATIVE_PTY_0_ON_STDINOUT=y

# MCUmgr server with UART transport
CONFIG_MCUMGR=y
CONFIG_UART_MCUMGR=y
CONFIG_MCUMGR_TRANSPORT_UART=y

# Shell with dummy backend (required by shell management group)
CONFIG_SHELL=y
CONFIG_SHELL_BACKEND_DUMMY=y

# MCUmgr shell command execution group
CONFIG_MCUMGR_GRP_SHELL=y

# Dependencies of MCUMGR
CONFIG_NET_BUF=y
CONFIG_ZCBOR=y
CONFIG_BASE64=y
CONFIG_CRC=y
```

## boards/native_sim.overlay
```dts
/*
 * Copyright (c) 2026 Golioth, Inc.
 *
 * SPDX-License-Identifier: Apache-2.0
 */

/* Point MCUmgr at uart1 (separate from console on uart0). */
/ {
	chosen {
		zephyr,uart-mcumgr = &uart1;
	};
};

/* serial_link_0 is documentation only; native_parallel_serial_link()
 * matches by domain + UART node name, not by label.
 */
serial_link_0: &uart1 {
	status = "okay";
	compatible = "zephyr,native-tty-uart";
	current-speed = <115200>;
};
```

## src/main.c
```c
/*
 * Copyright (c) 2026 Golioth, Inc.
 *
 * SPDX-License-Identifier: Apache-2.0
 */

/**
 * MCUmgr Shell Server
 *
 * The MCUmgr subsystem auto-registers at SYS_INIT time:
 * - SMP UART transport (via CONFIG_MCUMGR_TRANSPORT_UART)
 * - Shell management group (via CONFIG_MCUMGR_GRP_SHELL)
 *
 * Zephyr's built-in shell commands (kernel version, kernel uptime, etc.)
 * are available automatically.  All this main() needs to do is keep the
 * system alive.
 */

#include <zephyr/kernel.h>

int main(void)
{
    printk("MCUmgr shell server ready\n");
    k_sleep(K_FOREVER);
    return 0;
}
```
