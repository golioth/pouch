## CMakeLists.txt
```
# Copyright (c) 2026 Golioth, Inc.
#
# SPDX-License-Identifier: Apache-2.0

cmake_minimum_required(VERSION 3.20.0)

find_package(Zephyr REQUIRED HINTS $ENV{ZEPHYR_BASE})
project(http_transport)

target_sources(app PRIVATE
  src/main.c
  src/credentials.c
  src/net.c
)

if(CONFIG_EXAMPLE_FW_UPDATE_SHA256_VERIFY)
    target_sources(app PRIVATE src/fw_update_test.c)
elseif(CONFIG_EXAMPLE_FW_UPDATE_FLASH)
    target_sources(app PRIVATE src/fw_update.c)
endif()

if(CONFIG_MODEM)
    target_sources(app PRIVATE src/modem.c)
endif()

if(CONFIG_WIFI)
    target_sources(app PRIVATE src/wifi.c)
endif()


if (NOT CONFIG_EXAMPLE_HTTP_CLIENT_TLS_LOAD_CA_FROM_FILESYSTEM)
    generate_inc_file_for_target(app src/isrgrootx1.der
        ${ZEPHYR_BINARY_DIR}/include/generated/pouch-ca-crt.inc)
    endif (NOT CONFIG_EXAMPLE_HTTP_CLIENT_TLS_LOAD_CA_FROM_FILESYSTEM)
```

## Kconfig
```
# Copyright (c) 2026 Golioth, Inc.
#
# SPDX-License-Identifier: Apache-2.0

source "$ZEPHYR_BASE/Kconfig"

menu "Example: Pouch HTTP Client"

config EXAMPLE_HTTP_CLIENT_LOG_LEVEL
    int "HTTP client example log level"
    default 4

config EXAMPLE_HTTP_CLIENT_SYNC_PERIOD_S
    int "HTTP client example sync period (s)"
    default 30

config EXAMPLE_CREDENTIALS_DIR
    string "Directory containing credentials"
    default "/lfs1/credentials"
    help
      Directory on mounted file system containing credentials.

config EXAMPLE_HTTP_CLIENT_TLS_CREDENTIALS
    int "Sec Tag to use when storing TLS credentials"
    default 515765868

config EXAMPLE_HTTP_CLIENT_TLS_LOAD_CA_FROM_FILESYSTEM
    bool "Load the server CA cert from LFS"
    default n
    help
        Optionally load the CA certificate used for TLS/mTLS from EXAMPLE_CREDENTIALS_DIR/ca.der. If
        this symbol is not selected, isrgrootx1 will be used.

config EXAMPLE_HTTP_CLIENT_GW_DEVICE_CRT_FILENAME
    string "Gateway device crt filename in filesystem"
    default "crt.der"
    help
        The filename used to store the mTLS device certificate in the filesystem. By default this is
        the same as the filename used for the Pouch device crt, but may be changed if different
        credentials are desired for mTLS versus Pouch.

config EXAMPLE_HTTP_CLIENT_GW_DEVICE_KEY_FILENAME
    string "Gateway device key filename in filesystem"
    default "key.der"
    help
        The filename used to store the mTLS device private key in the filesystem. By default this is
        the same as the filename used for the Pouch device key, but may be changed if different
        credentials are desired for mTLS versus Pouch.

config EXAMPLE_FW_UPDATE_COMPONENT
    string "OTA component to use for firmware update"
    default "http_client_example"
    help
      Name of component in OTA manifest to use for firmware update.

choice EXAMPLE_FW_UPDATE_MODE
    prompt "Firmware update mode"
    depends on GOLIOTH_OTA
    default EXAMPLE_FW_UPDATE_FLASH

config EXAMPLE_FW_UPDATE_FLASH
    bool "Normal (write to flash)"
    help
        OTA component data is written to flash and mcuboot upgrade is requested.

config EXAMPLE_FW_UPDATE_SHA256_VERIFY
    bool "Download only and verify SHA256"
    help
        OTA component data is hashed with SHA256 instead of written
        to flash. The resulting hash is logged to the console for verification.

endchoice
endmenu # Example: Pouch HTTP Client
```

## sample.yaml
```
sample:
  name: Pouch HTTP Client
common:
  harness: pytest
  timeout: 180
tests:
  pouch.http_client.sample:
    harness_config:
      pytest_dut_scope: module
      pytest_root:
        - pytest/test_sample.py
      pytest_args:
        - --ota-mode=dummy
    platform_allow:
      - native_sim
      - native_sim/native/64
    extra_configs:
      - CONFIG_FILE_SYSTEM_NSIM_MOUNT=y
      - 'CONFIG_NATIVE_EXTRA_CMDLINE_ARGS="-volume=./creds:/creds"'
      - 'CONFIG_EXAMPLE_CREDENTIALS_DIR="/creds"'
      - CONFIG_EXAMPLE_HTTP_CLIENT_SYNC_PERIOD_S=2
      - CONFIG_EXAMPLE_FW_UPDATE_SHA256_VERIFY=y
      - CONFIG_GOLIOTH_OTA_MAX_VERSION_LEN=64
      - 'CONFIG_EXAMPLE_FW_UPDATE_COMPONENT="ci_ota_fw"'
  pouch.http_client.hil:
    harness_config:
      pytest_dut_scope: module
      pytest_root:
        - pytest/test_sample.py
    timeout: 960
    sysbuild: true
    extra_configs:
      - CONFIG_EXAMPLE_HTTP_CLIENT_SYNC_PERIOD_S=10
      - CONFIG_GOLIOTH_OTA_MAX_PACKAGE_NAME_LEN=64
      - CONFIG_GOLIOTH_OTA_MAX_VERSION_LEN=64
      # The auto negotiation timeout is normally 4 seconds, which often ends up failing:
      - CONFIG_PHY_AUTONEG_TIMEOUT_MS=30000
      - 'platform:frdm_rw612/rw612:CONFIG_EXAMPLE_FW_UPDATE_COMPONENT="hil_ota_frdm_rw612_http_client"'
    platform_allow:
      - frdm_rw612
```

## prj.conf
```kconfig
# General config
CONFIG_MAIN_STACK_SIZE=8192
CONFIG_SYSTEM_WORKQUEUE_STACK_SIZE=2048
CONFIG_MAIN_THREAD_PRIORITY=10

# Networking config
CONFIG_NETWORKING=y
CONFIG_NET_IPV4=y
CONFIG_NET_IPV6=n
CONFIG_NET_TCP=y
CONFIG_NET_SHELL=y
CONFIG_NET_SOCKETS_CONNECT_TIMEOUT=6000
CONFIG_NET_SOCKETS_SOCKOPT_TLS=y
CONFIG_DNS_RESOLVER=y

# Sockets
CONFIG_NET_SOCKETS=y
CONFIG_ZVFS_POLL_MAX=4
CONFIG_POSIX_API=y

# Network driver config
CONFIG_TEST_RANDOM_GENERATOR=y

# Network buffers
CONFIG_NET_PKT_RX_COUNT=16
CONFIG_NET_PKT_TX_COUNT=8
CONFIG_NET_BUF_DATA_SIZE=512
CONFIG_NET_BUF_RX_COUNT=24
CONFIG_NET_BUF_TX_COUNT=16
CONFIG_NET_CONTEXT_NET_PKT_POOL=y
CONFIG_NET_SOCKETS_TLS_MAX_CONTEXTS=6

# Network address config
CONFIG_NET_CONFIG_SETTINGS=y
CONFIG_NET_CONFIG_NEED_IPV4=y
CONFIG_NET_CONFIG_NEED_IPV6=n

# HTTP
CONFIG_HTTP_CLIENT=y

# Enable flash operations
CONFIG_FLASH=y
CONFIG_FLASH_MAP=y
CONFIG_STREAM_FLASH=y
CONFIG_IMG_MANAGER=y
CONFIG_IMG_ERASE_PROGRESSIVELY=y

# Enable the LittleFS file system
CONFIG_FILE_SYSTEM=y
CONFIG_FILE_SYSTEM_LITTLEFS=y
CONFIG_FILE_SYSTEM_SHELL=y

# Network debug config
CONFIG_LOG=y
CONFIG_NET_LOG=y
CONFIG_NET_SOCKETS_LOG_LEVEL_DBG=n
CONFIG_NET_HTTP_LOG_LEVEL_DBG=n

# TLS configuration
CONFIG_MBEDTLS=y
CONFIG_MBEDTLS_BUILTIN=y
CONFIG_MBEDTLS_ENABLE_HEAP=y
CONFIG_MBEDTLS_HEAP_SIZE=60000
CONFIG_MBEDTLS_SSL_MAX_CONTENT_LEN=16384
CONFIG_MBEDTLS_SSL_PROTO_TLS1_2=y
CONFIG_MBEDTLS_X509_CRT_PARSE_C=y
CONFIG_MBEDTLS_KEY_EXCHANGE_ECDHE_ECDSA_ENABLED=y

# TLS for Golioth (via PSA Crypto)
CONFIG_PSA_WANT_ALG_ECDH=y
CONFIG_PSA_WANT_ALG_ECDSA=y
CONFIG_PSA_WANT_ALG_GCM=y
CONFIG_PSA_WANT_ALG_RSA_PKCS1V15_SIGN=y
CONFIG_PSA_WANT_ALG_SHA_256=y
CONFIG_PSA_WANT_ALG_SHA_384=y
CONFIG_PSA_WANT_ALG_TLS12_PRF=y
CONFIG_PSA_WANT_ECC_SECP_R1_256=y
CONFIG_PSA_WANT_ECC_SECP_R1_384=y
CONFIG_PSA_WANT_KEY_TYPE_AES=y
CONFIG_PSA_WANT_KEY_TYPE_ECC_KEY_PAIR_GENERATE=y
CONFIG_PSA_WANT_KEY_TYPE_ECC_KEY_PAIR_IMPORT=y
CONFIG_PSA_WANT_KEY_TYPE_ECC_KEY_PAIR_EXPORT=y
CONFIG_PSA_WANT_KEY_TYPE_ECC_PUBLIC_KEY=y
CONFIG_PSA_WANT_KEY_TYPE_RSA_PUBLIC_KEY=y
CONFIG_PSA_WANT_KEY_TYPE_RSA_KEY_PAIR_IMPORT=y

# Configure Pouch
CONFIG_POUCH=y
CONFIG_POUCH_TRANSPORT_HTTP_CLIENT=y
CONFIG_GOLIOTH=y
CONFIG_GOLIOTH_SETTINGS=y
CONFIG_GOLIOTH_OTA=y

# Enable mcumgr
CONFIG_ZCBOR=y
CONFIG_MCUMGR=y

# Enable the shell mcumgr transport. This allows SMP messages to pass
# through the shell to the mgmt subsystem.
CONFIG_BASE64=y
CONFIG_CRC=y
CONFIG_MCUMGR_TRANSPORT_SHELL=y

# Enable mcumgr params to allow smpmgr to query device for its MTU
CONFIG_MCUMGR_GRP_OS=y
CONFIG_MCUMGR_GRP_OS_MCUMGR_PARAMS=y

# Enable file system commands
CONFIG_MCUMGR_GRP_FS=y
CONFIG_MCUMGR_GRP_FS_FILE_ACCESS_HOOK=y
CONFIG_MCUMGR_MGMT_NOTIFICATION_HOOKS=y
```

## boards/frdm_rw612.conf
```kconfig
CONFIG_NET_DHCPV4=y
CONFIG_BUILD_OUTPUT_HEX=y
CONFIG_REBOOT=y

CONFIG_MCUMGR_TRANSPORT_WORKQUEUE_STACK_SIZE=4096
```

## boards/frdm_rw612_wifi.conf
```kconfig
# Extra configuration file for using NXP frdm_rw612 with WiFi instead of Ethernet
#   To use, add as extra conf file:
#   west build -p -b frdm_rw612 <path_to>/examples/zephyr/http_client -- -DEXTRA_CONF_FILE=boards/frdm_rw612_wifi.conf
#
CONFIG_WIFI=y
CONFIG_WIFI_NXP=y

# Store credentials in settings, on filesystem
CONFIG_SETTINGS=y
CONFIG_SETTINGS_FILE_PATH="/lfs1/settings"

# Ensure that filesystem initializes before settings
CONFIG_FILE_SYSTEM_INIT_PRIORITY=89

# Runtime provisioning for WiFi credentials
CONFIG_WIFI_CREDENTIALS=y
CONFIG_NET_L2_WIFI_SHELL=y
CONFIG_SHELL_STACK_SIZE=2560

# Wifi Configuration
CONFIG_NET_L2_ETHERNET=y
CONFIG_NET_PKT_RX_COUNT=36
CONFIG_NET_PKT_TX_COUNT=36
CONFIG_NET_BUF_RX_COUNT=40
CONFIG_NET_BUF_TX_COUNT=40
CONFIG_NET_BUF_DATA_SIZE=1744

# Handle WiFi Networks with Multiple DNS Servers
CONFIG_DNS_RESOLVER_MAX_SERVERS=3

# Disable Ethernet
CONFIG_ETH_NXP_ENET=n
CONFIG_PHY_MICROCHIP_KSZ8081=n
CONFIG_NET_CONFIG_AUTO_INIT=n
CONFIG_NET_CONFIG_NEED_IPV4=n
```

## boards/nrf9160dk_nrf52840.conf
```kconfig
# PPP
CONFIG_NET_L2_PPP=y
CONFIG_NET_L2_PPP_OPTION_DNS_USE=y

# Network management
CONFIG_NET_MGMT=y
CONFIG_NET_MGMT_EVENT=y
CONFIG_NET_CONNECTION_MANAGER=y

# Modem driver
CONFIG_MODEM=y
CONFIG_MODEM_CELLULAR=y

# Align with the Serial LTE Modem (SLM) application.
CONFIG_MODEM_CELLULAR_UART_BUFFER_SIZES=6000

# CMUX configuration
# MTU must accommodate PPP frames (up to 1500 bytes for IP packets)
CONFIG_MODEM_CMUX_MTU=1500
CONFIG_MODEM_CMUX_WORK_BUFFER_SIZE_EXTRA=1024

# NB-IoT latency can reach 10s; use greater timeouts
CONFIG_NET_SOCKETS_DNS_TIMEOUT=15000
CONFIG_NET_SOCKETS_CONNECT_TIMEOUT=15000
```

## socs/native.conf
```kconfig
# Use offloaded sockets using host BSD sockets
CONFIG_ETH_DRIVER=n
CONFIG_ETH_NATIVE_TAP=n
CONFIG_NET_DRIVERS=y
CONFIG_NET_SOCKETS=y
CONFIG_NET_SOCKETS_OFFLOAD=y
CONFIG_NET_NATIVE_OFFLOADED_SOCKETS=y

# Use embedded libc to use Zephyr's eventfd instead of host eventfd
CONFIG_PICOLIBC=y

# Static networking
CONFIG_NET_CONFIG_LOG_LEVEL_DBG=y
CONFIG_NET_CONFIG_SETTINGS=y
CONFIG_NET_CONFIG_NEED_IPV4=y
CONFIG_NET_CONFIG_MY_IPV4_ADDR="192.0.2.1"
```

## src/main.c
```c
/*
 * Copyright (c) 2025 Golioth
 *
 * SPDX-License-Identifier: Apache-2.0
 */

#include <zephyr/logging/log.h>
LOG_MODULE_REGISTER(http_transport, CONFIG_EXAMPLE_HTTP_CLIENT_LOG_LEVEL);

#include "credentials.h"
#include "net.h"

#include <zephyr/drivers/gpio.h>
#include <zephyr/net/socket.h>
#include <zephyr/net/http/client.h>
#include <zephyr/net/tls_credentials.h>

#include <pouch/pouch.h>
#include <pouch/events.h>
#include <pouch/uplink.h>
#include <pouch/downlink.h>
#include <pouch/transport/certificate.h>
#include <pouch/transport/http/client.h>

#include <golioth/settings_callbacks.h>

static const struct gpio_dt_spec led = GPIO_DT_SPEC_GET_OR(DT_ALIAS(led0), gpios, {});

static void do_uplink(void)
{
    const char *payload = "{\"temp\":22}";
    pouch_uplink_entry_write(".s/sensor",
                             POUCH_CONTENT_TYPE_JSON,
                             payload,
                             strlen(payload),
                             POUCH_FOREVER);
}
POUCH_UPLINK_HANDLER(do_uplink);

static int led_setting_cb(bool new_value)
{
    LOG_INF("Received LED setting: %d", (int) new_value);

    if (DT_HAS_ALIAS(led0))
    {
        gpio_pin_set_dt(&led, new_value ? 1 : 0);
    }

    return 0;
}

GOLIOTH_SETTINGS_HANDLER(LED, led_setting_cb);

static void setup_led(void)
{
    if (!DT_HAS_ALIAS(led0))
    {
        return;
    }

    int err = gpio_pin_configure_dt(&led, GPIO_OUTPUT_ACTIVE);
    if (err < 0)
    {
        LOG_WRN("Could not initialize LED");
    }
}

int main(void)
{
    struct pouch_config config = {0};

    /* Load certificates for Pouch */
    int err = load_certificate(&config.certificate);
    if (err)
    {
        LOG_ERR("Failed to load certificate (err %d)", err);
        return 0;
    }

    config.private_key = load_private_key();
    if (config.private_key == PSA_KEY_ID_NULL)
    {
        LOG_ERR("Failed to load private key");
        return 0;
    }

    LOG_INF("Credentials loaded");

    err = pouch_init(&config);
    if (err)
    {
        LOG_ERR("Pouch init failed (err %d)", err);
        return 0;
    }

    /* Load certificates for HTTP mTLS transport */
    err = load_http_server_ca(CONFIG_EXAMPLE_HTTP_CLIENT_TLS_CREDENTIALS);
    if (err)
    {
        LOG_ERR("Failed to load server CA certificate (err %d)", err);
        return 0;
    }

    err = load_http_gw_device_crt(CONFIG_EXAMPLE_HTTP_CLIENT_TLS_CREDENTIALS);
    if (err)
    {
        LOG_ERR("Failed to load device certificate (err %d)", err);
        return 0;
    }

    err = load_http_gw_device_key(CONFIG_EXAMPLE_HTTP_CLIENT_TLS_CREDENTIALS);
    if (err)
    {
        LOG_ERR("Failed to load device key (err %d)", err);
        return 0;
    }

    setup_led();

    net_connect();

    err = pouch_http_client_init(CONFIG_EXAMPLE_HTTP_CLIENT_TLS_CREDENTIALS, K_FOREVER);
    if (0 != err)
    {
        LOG_ERR("Failed to initialize HTTP client transport");
        return err;
    }

    while (1)
    {
        /* Sync Pouch uplink and downlink */
        pouch_http_client_sync(K_NO_WAIT);

        k_sleep(K_SECONDS(CONFIG_EXAMPLE_HTTP_CLIENT_SYNC_PERIOD_S));
    }

    return err;
}
```

## src/credentials.c
```c
/*
 * Copyright (c) 2025 Golioth, Inc.
 *
 * SPDX-License-Identifier: Apache-2.0
 */
#include <stdlib.h>
#include <zephyr/fs/fs.h>
#include <zephyr/init.h>
#include <pouch/pouch.h>
#include <mbedtls/pk.h>
#include <mbedtls/psa_util.h>
#include <zephyr/net/tls_credentials.h>

#include <zephyr/logging/log.h>
LOG_MODULE_REGISTER(credentials);

#define CERT_DIR CONFIG_EXAMPLE_CREDENTIALS_DIR
#define TLS_CA_FILE CERT_DIR "/ca.der"
#define GW_CERT_FILE CERT_DIR "/" CONFIG_EXAMPLE_HTTP_CLIENT_GW_DEVICE_CRT_FILENAME
#define GW_KEY_FILE CERT_DIR "/" CONFIG_EXAMPLE_HTTP_CLIENT_GW_DEVICE_KEY_FILENAME
#define CERT_FILE CERT_DIR "/crt.der"
#define KEY_FILE CERT_DIR "/key.der"

struct mutual_tls_pki
{
    uint8_t *ca_cert;
    ssize_t ca_cert_len;
    uint8_t *gw_crt;
    ssize_t gw_crt_len;
    uint8_t *gw_key;
    ssize_t gw_key_len;
} _m_tls_ctx;

#ifndef CONFIG_EXAMPLE_HTTP_CLIENT_TLS_LOAD_CA_FROM_FILESYSTEM
static const uint8_t tls_ca_crt[] = {
#include "pouch-ca-crt.inc"
};
#endif  // CONFIG_EXAMPLE_HTTP_CLIENT_TLS_LOAD_CA_FROM_FILESYSTEM

/** Load the raw private key data into PSA */
static psa_key_id_t import_raw_pk(const uint8_t *private_key, size_t size)
{
    mbedtls_pk_context pk;
    mbedtls_pk_init(&pk);
    int err = mbedtls_pk_parse_key(&pk, private_key, size, NULL, 0);
    if (err)
    {
        LOG_ERR("Failed to parse key: -0x%x", -err);
        return PSA_KEY_ID_NULL;
    }

    psa_key_attributes_t attrs = PSA_KEY_ATTRIBUTES_INIT;

    psa_set_key_algorithm(&attrs, PSA_ALG_ECDH);
    psa_set_key_type(&attrs, PSA_KEY_TYPE_ECC_KEY_PAIR(PSA_ECC_FAMILY_SECP_R1));
    psa_set_key_usage_flags(&attrs, PSA_KEY_USAGE_DERIVE);

    psa_key_id_t key_id;
    err = mbedtls_pk_import_into_psa(&pk, &attrs, &key_id);
    if (err)
    {
        LOG_ERR("Failed to import private key: -0x%x", -err);
        return PSA_KEY_ID_NULL;
    }

    return key_id;
}

static int ensure_credentials_dir(void)
{
    struct fs_dirent dirent;

    int err = fs_stat(CERT_DIR, &dirent);
    if (err == -ENOENT)
    {
        err = fs_mkdir(CERT_DIR);
    }

    if (err)
    {
        LOG_ERR("Failed to create credentials dir: %d", err);
    }

    return err;
}

/* Run after filesystem mounts, before SMP provisioning */
SYS_INIT(ensure_credentials_dir, APPLICATION, 85);

static ssize_t get_file_size(const char *path)
{
    struct fs_dirent dirent;

    int err = fs_stat(path, &dirent);

    if (err < 0)
    {
        return err;
    }
    if (dirent.type != FS_DIR_ENTRY_FILE)
    {
        return -EISDIR;
    }

    return dirent.size;
}

static ssize_t read_file(const char *path, uint8_t **out)
{
    ssize_t size = get_file_size(path);
    if (size <= 0)
    {
        return size;
    }

    uint8_t *buf = malloc(size);
    if (buf == NULL)
    {
        return -ENOMEM;
    }

    struct fs_file_t file;
    fs_file_t_init(&file);

    int err = fs_open(&file, path, FS_O_READ);
    if (err)
    {
        LOG_ERR("Could not open %s, err: %d", path, err);
        free(buf);
        return err;
    }

    size = fs_read(&file, buf, size);
    if (size < 0)
    {
        LOG_ERR("Could not read %s, err: %d", path, size);
        free(buf);
        goto finish;
    }

    LOG_DBG("Read %d bytes from %s", size, path);

    *out = buf;

finish:
    fs_close(&file);
    return size;
}

psa_key_id_t load_private_key(void)
{
    uint8_t *buf;
    ssize_t size = read_file(KEY_FILE, &buf);
    if (size < 0)
    {
        return PSA_KEY_ID_NULL;
    }

    psa_key_id_t key_id = import_raw_pk(buf, size);
    free(buf);
    return key_id;
}

int load_certificate(struct pouch_cert *cert)
{
    uint8_t *buf;
    ssize_t size = read_file(CERT_FILE, &buf);
    if (size < 0)
    {
        return size;
    }

    cert->buffer = buf;
    cert->size = size;

    LOG_DBG("Read certificate (%d bytes)", size);

    return 0;
}

void free_certificate(struct pouch_cert *cert)
{
    free((void *) cert->buffer);
}

ssize_t load_file_to_tls(char *fn, sec_tag_t sec_tag, enum tls_credential_type type, uint8_t **buf)
{
    ssize_t size = read_file(fn, buf);
    if (size < 0)
    {
        return size;
    }

    int err = tls_credential_add(sec_tag, type, *buf, size);
    return err;
}

int load_http_server_ca(sec_tag_t sec_tag)
{
#ifdef CONFIG_EXAMPLE_HTTP_CLIENT_TLS_LOAD_CA_FROM_FILESYSTEM
    if (NULL != _m_tls_ctx.ca_cert)
    {
        LOG_ERR("Free existing ca cert before loading");
        return -EEXIST;
    }

    _m_tls_ctx.ca_cert_len =
        load_file_to_tls(TLS_CA_FILE, sec_tag, TLS_CREDENTIAL_CA_CERTIFICATE, &_m_tls_ctx.ca_cert);
    return _m_tls_ctx.ca_cert_len;
#else
    return tls_credential_add(sec_tag,
                              TLS_CREDENTIAL_CA_CERTIFICATE,
                              tls_ca_crt,
                              sizeof(tls_ca_crt));
#endif
}

int load_http_gw_device_crt(sec_tag_t sec_tag)
{
    if (NULL != _m_tls_ctx.gw_crt)
    {
        LOG_ERR("Free existing gw cert before loading");
        return -EEXIST;
    }

    _m_tls_ctx.gw_crt_len = load_file_to_tls(GW_CERT_FILE,
                                             sec_tag,
                                             TLS_CREDENTIAL_PUBLIC_CERTIFICATE,
                                             &_m_tls_ctx.gw_crt);
    return _m_tls_ctx.gw_crt_len;
}

int load_http_gw_device_key(sec_tag_t sec_tag)
{
    if (NULL != _m_tls_ctx.gw_key)
    {
        LOG_ERR("Free existing gw key before loading");
        return -EEXIST;
    }

    _m_tls_ctx.gw_key_len =
        load_file_to_tls(GW_KEY_FILE, sec_tag, TLS_CREDENTIAL_PRIVATE_KEY, &_m_tls_ctx.gw_key);
    return _m_tls_ctx.gw_key_len;
}

void free_http_certs(void)
{
#ifdef CONFIG_EXAMPLE_HTTP_CLIENT_TLS_LOAD_CA_FROM_FILESYSTEM
    free(_m_tls_ctx.ca_cert);
#endif
    _m_tls_ctx.ca_cert = NULL;
    _m_tls_ctx.ca_cert_len = 0;

    free(_m_tls_ctx.gw_crt);
    _m_tls_ctx.gw_crt = NULL;
    _m_tls_ctx.gw_crt_len = 0;

    free(_m_tls_ctx.gw_key);
    _m_tls_ctx.gw_key = NULL;
    _m_tls_ctx.gw_key_len = 0;
}
```

## src/credentials.h
```c
/*
 * Copyright (c) 2025 Golioth, Inc.
 *
 * SPDX-License-Identifier: Apache-2.0
 */
#pragma once
#include <psa/crypto.h>
#include <pouch/types.h>
#include <zephyr/net/tls_credentials.h>

/**
 * Import the device private key into PSA
 *
 * @returns The assigned PSA key ID for the device's private key, or @c PSA_KEY_ID_NULL if the
 * private key couldn't be loaded.
 */
psa_key_id_t load_private_key(void);

/**
 * Load the device certificate.
 */
int load_certificate(struct pouch_cert *cert);

/** Free the device certificate. */
void free_certificate(struct pouch_cert *cert);

/**
 * Load server CA certificate needed for HTTPS connection.
 */
int load_http_server_ca(sec_tag_t sec_tag);

/**
 * Load Gateway device certificate needed for HTTPS connection.
 */
int load_http_gw_device_crt(sec_tag_t sec_tag);

/**
 * Load Gateway device private key needed for HTTPS connection.
 */
int load_http_gw_device_key(sec_tag_t sec_tag);

/**
 * Free the HTTPS credential.
 */
void free_http_certs(void);
```

## src/fw_update_test.c
```c
/*
 * Copyright (c) 2026 Golioth
 *
 * SPDX-License-Identifier: Apache-2.0
 */

#include <zephyr/logging/log.h>
LOG_MODULE_REGISTER(fw_update_test);

#include <stdio.h>
#include <zephyr/kernel.h>
#include <zephyr/app_version.h>
#include <psa/crypto.h>

#include <golioth/ota.h>

static void log_sha256(const char *name, const uint8_t hash[32])
{
    char hex[65];

    for (int i = 0; i < 32; i++)
    {
        snprintf(&hex[i * 2], 3, "%02x", hash[i]);
    }

    LOG_INF("OTA %s SHA256: %s", name, hex);
}

static psa_hash_operation_t hash_op;
static size_t total_received;

static void ota_fw_receive(const void *data, size_t offset, size_t len, bool is_last)
{
    psa_status_t status;

    if (0 == offset)
    {
        hash_op = psa_hash_operation_init();
        status = psa_hash_setup(&hash_op, PSA_ALG_SHA_256);
        if (PSA_SUCCESS != status)
        {
            LOG_ERR("Failed to init SHA256: %d", status);
            return;
        }
        total_received = 0;
    }

    status = psa_hash_update(&hash_op, data, len);
    if (PSA_SUCCESS != status)
    {
        LOG_ERR("Failed to update SHA256: %d", status);
        return;
    }

    total_received += len;

    if (is_last)
    {
        uint8_t hash[32];
        size_t hash_len;

        status = psa_hash_finish(&hash_op, hash, sizeof(hash), &hash_len);
        if (PSA_SUCCESS != status)
        {
            LOG_ERR("Failed to finish SHA256: %d", status);
            return;
        }

        LOG_INF("OTA download complete: %zu bytes", total_received);
        log_sha256("computed", hash);

        golioth_ota_mark_idle(CONFIG_EXAMPLE_FW_UPDATE_COMPONENT);
    }
}

static void ota_manifest_receive(const struct golioth_ota_manifest_component *components,
                                 size_t num_components)
{
    for (int i = 0; i < num_components; i++)
    {
        LOG_DBG("OTA manifest: %s current=%s target=%s size=%d",
                components[i].name,
                components[i].current,
                components[i].target,
                components[i].size);

        log_sha256("manifest", components[i].target_hash);

        if (0 != strcmp(components[i].current, components[i].target))
        {
            golioth_ota_mark_for_download(components[i].name);
        }
    }
}

GOLIOTH_OTA_COMPONENT(fw, CONFIG_EXAMPLE_FW_UPDATE_COMPONENT, APP_VERSION_STRING, ota_fw_receive);
GOLIOTH_OTA_MANIFEST_HANDLER(ota_manifest_receive);
```

## src/net.h
```c
/*
 * Copyright (c) 2026 Golioth, Inc.
 *
 * SPDX-License-Identifier: Apache-2.0
 */

#pragma once

void net_connect(void);
```

## src/wifi.c
```c
/*
 * Copyright (c) 2026 Golioth
 *
 * SPDX-License-Identifier: Apache-2.0
 */

#include <zephyr/logging/log.h>
LOG_MODULE_REGISTER(example_wifi);

#include <zephyr/net/wifi_mgmt.h>
#include <zephyr/net/net_if.h>
#include <zephyr/net/net_event.h>
#include <zephyr/net/wifi_credentials.h>
#include <zephyr/settings/settings.h>

static K_SEM_DEFINE(wifi_connected, 0, 1);
static struct net_mgmt_event_callback wifi_cb;

static void connect_cb(void *cb_arg, const char *ssid, size_t ssid_len)
{
    struct net_if *iface = cb_arg;
    struct wifi_credentials_personal creds = {0};

    if (wifi_credentials_get_by_ssid_personal_struct(ssid, ssid_len, &creds) == 0)
    {
        struct wifi_connect_req_params params = {
            .ssid = creds.header.ssid,
            .ssid_length = creds.header.ssid_len,
            .psk = creds.password,
            .psk_length = creds.password_len,
            .security = creds.header.type,
        };
        net_mgmt(NET_REQUEST_WIFI_CONNECT, iface, &params, sizeof(params));
    }
}

static void wifi_mgmt_event_handler(struct net_mgmt_event_callback *cb,
                                    uint64_t mgmt_event,
                                    struct net_if *iface)
{
    if (mgmt_event == NET_EVENT_WIFI_CONNECT_RESULT)
    {
        const struct wifi_status *status = (const struct wifi_status *) cb->info;

        if (status->status)
        {
            LOG_ERR("WiFi connection failed (status %d)", status->status);
        }
        else
        {
            LOG_INF("WiFi connected");
            k_sem_give(&wifi_connected);
        }
    }
}

void wifi_connect(void)
{
    net_mgmt_init_event_callback(&wifi_cb, wifi_mgmt_event_handler, NET_EVENT_WIFI_CONNECT_RESULT);
    net_mgmt_add_event_callback(&wifi_cb);

    LOG_INF("Initializing settings");
    settings_subsys_init();
    settings_load();

    LOG_INF("Connecting to WiFi");
    struct net_if *iface = net_if_get_wifi_sta();
    if (wifi_credentials_is_empty())
    {
        LOG_ERR("No WiFi credentials available");
        LOG_ERR("   After using `wifi cred add ...` to set, run `kernel reboot`");
        k_sleep(K_FOREVER);
    }
    wifi_credentials_for_each_ssid(connect_cb, iface);

    k_sem_take(&wifi_connected, K_FOREVER);
}
```
