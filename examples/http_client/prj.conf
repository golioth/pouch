## CMakeLists.txt
```
# Copyright (c) 2026 Golioth, Inc.
#
# SPDX-License-Identifier: Apache-2.0

cmake_minimum_required(VERSION 3.20.0)

find_package(Zephyr REQUIRED HINTS $ENV{ZEPHYR_BASE})
project(http_transport)

target_sources(app PRIVATE
  src/main.c
  src/credentials.c
)

if(CONFIG_EXAMPLE_FW_UPDATE_SHA256_VERIFY)
    target_sources(app PRIVATE src/fw_update_test.c)
elseif(CONFIG_EXAMPLE_FW_UPDATE_FLASH)
    target_sources(app PRIVATE src/fw_update.c)
endif()

if (NOT CONFIG_EXAMPLE_HTTP_CLIENT_TLS_LOAD_CA_FROM_FILESYSTEM)
    generate_inc_file_for_target(app src/isrgrootx1.der
        ${ZEPHYR_BINARY_DIR}/include/generated/pouch-ca-crt.inc)
    endif (NOT CONFIG_EXAMPLE_HTTP_CLIENT_TLS_LOAD_CA_FROM_FILESYSTEM)
```

## Kconfig
```
# Copyright (c) 2026 Golioth, Inc.
#
# SPDX-License-Identifier: Apache-2.0

source "$ZEPHYR_BASE/Kconfig"

config EXAMPLE_HTTP_CLIENT_LOG_LEVEL
    int "HTTP client example log level"
    default 4

config EXAMPLE_HTTP_CLIENT_SYNC_PERIOD_S
    int "HTTP client example sync period (s)"
    default 30

config EXAMPLE_CREDENTIALS_DIR
    string "Directory containing credentials"
    default "/lfs1/credentials"
    help
      Directory on mounted file system containing credentials.

config EXAMPLE_HTTP_CLIENT_TLS_CREDENTIALS
    int "Sec Tag to use when storing TLS credentials"
    default 515765868

config EXAMPLE_HTTP_CLIENT_TLS_LOAD_CA_FROM_FILESYSTEM
    bool "Load the cerver CA cert from LFS"
    default n
    help
        Optionally load the CA certificate used for TLS/mTLS from EXAMPLE_CREDENTIALS_DIR/ca.der. If
        this symbol is not selected, isrgrootx1 will be used.

config EXAMPLE_HTTP_CLIENT_GW_DEVICE_CRT_FILENAME
    string "Gateway device crt filename in filesystem"
    default "crt.der"
    help
        The filename used to store the mTLS device certificate in the filesystem. By default this is
        the same as the filename used for the Pouch device crt, but may be changed if different
        credentials are desired for mTLS versus Pouch.

config EXAMPLE_HTTP_CLIENT_GW_DEVICE_KEY_FILENAME
    string "Gateway device key filename in filesystem"
    default "key.der"
    help
        The filename used to store the mTLS device private key in the filesystem. By default this is
        the same as the filename used for the Pouch device key, but may be changed if different
        credentials are desired for mTLS versus Pouch.

config GOLIOTH_SAMPLE_WIFI_STACK_SIZE
	int "WiFi manager stack size"
	default 2048

config GOLIOTH_SAMPLE_WIFI_INIT_PRIORITY
	int "WiFi manager init priority"
	default 90

config GOLIOTH_SAMPLE_WIFI_THREAD_PRIORITY
	int "WiFi manager thread priority"
	default 7
```

## sample.yaml
```
sample:
  name: Pouch HTTP Client
common:
  harness: pytest
  harness_config:
    pytest_dut_scope: module
  platform_allow:
    - native_sim
    - native_sim/native/64
  integration_platforms:
    - native_sim
    - native_sim/native/64
  timeout: 180
tests:
  pouch.http_client.settings:
    harness_config:
      pytest_root:
        - pytest/test_sample.py
    extra_configs:
      - CONFIG_FILE_SYSTEM_NSIM_MOUNT=y
      - 'CONFIG_NATIVE_EXTRA_CMDLINE_ARGS="-volume=./creds:/creds"'
      - 'CONFIG_EXAMPLE_CREDENTIALS_DIR="/creds"'
      - CONFIG_EXAMPLE_HTTP_CLIENT_SYNC_PERIOD_S=2
  pouch.http_client.ota:
    harness_config:
      pytest_root:
        - pytest/test_ota.py
    extra_configs:
      - CONFIG_FILE_SYSTEM_NSIM_MOUNT=y
      - 'CONFIG_NATIVE_EXTRA_CMDLINE_ARGS="-volume=./creds:/creds"'
      - 'CONFIG_EXAMPLE_CREDENTIALS_DIR="/creds"'
      - CONFIG_EXAMPLE_HTTP_CLIENT_SYNC_PERIOD_S=2
      - CONFIG_EXAMPLE_FW_UPDATE_SHA256_VERIFY=y
```

## prj.conf
```kconfig
# General config
CONFIG_MAIN_STACK_SIZE=4096
CONFIG_SYSTEM_WORKQUEUE_STACK_SIZE=2048
CONFIG_MAIN_THREAD_PRIORITY=10

# Networking config
CONFIG_NETWORKING=y
CONFIG_NET_IPV4=y
CONFIG_NET_IPV6=n
CONFIG_NET_TCP=y
CONFIG_NET_SHELL=y
CONFIG_NET_SOCKETS_CONNECT_TIMEOUT=6000
CONFIG_NET_SOCKETS_SOCKOPT_TLS=y
CONFIG_DNS_RESOLVER=y

# Sockets
CONFIG_NET_SOCKETS=y
CONFIG_ZVFS_POLL_MAX=4
CONFIG_POSIX_API=y

# Network driver config
CONFIG_TEST_RANDOM_GENERATOR=y

# Network buffers
CONFIG_NET_PKT_RX_COUNT=16
CONFIG_NET_PKT_TX_COUNT=8
CONFIG_NET_BUF_DATA_SIZE=512
CONFIG_NET_BUF_RX_COUNT=24
CONFIG_NET_BUF_TX_COUNT=16
CONFIG_NET_CONTEXT_NET_PKT_POOL=y
CONFIG_NET_SOCKETS_TLS_MAX_CONTEXTS=6

# Network address config
CONFIG_NET_CONFIG_SETTINGS=y
CONFIG_NET_CONFIG_NEED_IPV4=y
CONFIG_NET_CONFIG_NEED_IPV6=n

# HTTP
CONFIG_HTTP_CLIENT=y

# Enable flash operations
CONFIG_FLASH=y
CONFIG_FLASH_MAP=y
CONFIG_STREAM_FLASH=y
CONFIG_IMG_MANAGER=y
CONFIG_IMG_ERASE_PROGRESSIVELY=y

# Enable the LittleFS file system
CONFIG_FILE_SYSTEM=y
CONFIG_FILE_SYSTEM_LITTLEFS=y
CONFIG_FILE_SYSTEM_SHELL=y

# Network debug config
CONFIG_LOG=y
CONFIG_NET_LOG=y
CONFIG_NET_SOCKETS_LOG_LEVEL_DBG=n
CONFIG_NET_HTTP_LOG_LEVEL_DBG=n

# Misc
CONFIG_HEAP_MEM_POOL_SIZE=4096

# TLS configuration
CONFIG_MBEDTLS=y
CONFIG_MBEDTLS_BUILTIN=y
CONFIG_MBEDTLS_ENABLE_HEAP=y
CONFIG_MBEDTLS_HEAP_SIZE=60000
CONFIG_MBEDTLS_SSL_MAX_CONTENT_LEN=16384

# TLS for Golioth
CONFIG_MBEDTLS_CIPHER_GCM_ENABLED=y
CONFIG_MBEDTLS_ECDH_C=y
CONFIG_MBEDTLS_ECDSA_C=y
CONFIG_MBEDTLS_ECP_C=y
CONFIG_MBEDTLS_ECP_DP_SECP256R1_ENABLED=y
CONFIG_MBEDTLS_ECP_DP_SECP384R1_ENABLED=y
CONFIG_MBEDTLS_KEY_EXCHANGE_ECDHE_ECDSA_ENABLED=y
CONFIG_MBEDTLS_KEY_EXCHANGE_ECDHE_RSA_ENABLED=y
CONFIG_MBEDTLS_RSA_C=y
CONFIG_MBEDTLS_SHA384=y

CONFIG_PSA_WANT_ALG_GCM=y
CONFIG_PSA_WANT_KEY_TYPE_ECC_KEY_PAIR_GENERATE=y
CONFIG_PSA_WANT_ALG_RSA_PKCS1V15_SIGN=y
CONFIG_PSA_WANT_ALG_TLS12_PRF=y

# Configure Pouch
CONFIG_POUCH=y
CONFIG_POUCH_TRANSPORT_HTTP_CLIENT=y
CONFIG_GOLIOTH=y
CONFIG_GOLIOTH_SETTINGS=y
CONFIG_GOLIOTH_OTA=y

# Enable mcumgr
CONFIG_ZCBOR=y
CONFIG_MCUMGR=y

# Enable the shell mcumgr transport. This allows SMP messages to pass
# through the shell to the mgmt subsystem.
CONFIG_BASE64=y
CONFIG_CRC=y
CONFIG_MCUMGR_TRANSPORT_SHELL=y

# Enable mcumgr params to allow smpmgr to query device for its MTU
CONFIG_MCUMGR_GRP_OS=y
CONFIG_MCUMGR_GRP_OS_MCUMGR_PARAMS=y

# Enable file system commands
CONFIG_MCUMGR_GRP_FS=y
CONFIG_MCUMGR_GRP_FS_FILE_ACCESS_HOOK=y
CONFIG_MCUMGR_MGMT_NOTIFICATION_HOOKS=y
```

## boards/frdm_rw612.conf
```kconfig
CONFIG_NET_DHCPV4=y
CONFIG_BUILD_OUTPUT_HEX=y
CONFIG_REBOOT=y

CONFIG_WIFI=y
CONFIG_WIFI_NXP=y

CONFIG_NET_L2_ETHERNET=y
CONFIG_NET_IPV4=y
CONFIG_NET_IF_MAX_IPV4_COUNT=3
CONFIG_NET_PKT_RX_COUNT=36
CONFIG_NET_PKT_TX_COUNT=36
CONFIG_NET_BUF_RX_COUNT=40
CONFIG_NET_BUF_TX_COUNT=40
CONFIG_NET_BUF_DATA_SIZE=1744

CONFIG_NET_L2_WIFI_SHELL=y
```

## boards/frdm_rw612_wifi.conf
```kconfig
CONFIG_WIFI=y
CONFIG_WIFI_NXP=y

# WiFi Provisioning
#   Use:
#     wifi cred add -s <ssid> -p <password> -k 1
#     wifi cred auto_connect
CONFIG_NET_L2_WIFI_SHELL=y
CONFIG_WIFI_CREDENTIALS=y
CONFIG_SETTINGS=y
CONFIG_SETTINGS_FILE_PATH="/lfs1/settings"
CONFIG_FILE_SYSTEM_INIT_PRIORITY=70
```

## app.overlay
```dts
/*
 * Copyright (c) 2025 Golioth, Inc.
 */
/ {
	fstab {
		compatible = "zephyr,fstab";
		lfs1: lfs1 {
			compatible = "zephyr,fstab,littlefs";
			mount-point = "/lfs1";
			partition = <&storage_partition>;
			automount;
			read-size = <16>;
			prog-size = <16>;
			cache-size = <64>;
			lookahead-size = <32>;
			block-cycles = <512>;
		};
	};
};
```

## boards/frdm_rw612_wifi.overlay
```dts
&enet_mac {
  status = "disabled";
};

/ {
	fstab {
		compatible = "zephyr,fstab";
		lfs1: lfs1 {
			compatible = "zephyr,fstab,littlefs";
			mount-point = "/lfs1";
			partition = <&storage_partition>;
			automount;
			read-size = <16>;
			prog-size = <16>;
			cache-size = <64>;
			lookahead-size = <32>;
			block-cycles = <512>;
		};
	};
};
```

## src/main.c
```c
/*
 * Copyright (c) 2025 Golioth
 *
 * SPDX-License-Identifier: Apache-2.0
 */

#include <zephyr/logging/log.h>
LOG_MODULE_REGISTER(http_transport, CONFIG_EXAMPLE_HTTP_CLIENT_LOG_LEVEL);

#include "credentials.h"

#include <zephyr/net/socket.h>
#include <zephyr/net/http/client.h>
#include <zephyr/net/tls_credentials.h>

#include <pouch/pouch.h>
#include <pouch/events.h>
#include <pouch/uplink.h>
#include <pouch/downlink.h>
#include <pouch/transport/certificate.h>
#include <pouch/transport/http/client.h>

#include <pouch/golioth/settings_callbacks.h>

static void do_uplink(void)
{
    const char *payload = "{\"temp\":22}";
    pouch_uplink_entry_write(".s/sensor",
                             POUCH_CONTENT_TYPE_JSON,
                             payload,
                             strlen(payload),
                             POUCH_TIMEOUT_FOREVER);
}
POUCH_UPLINK_HANDLER(do_uplink);

static int led_setting_cb(bool new_value)
{
    LOG_INF("Received LED setting: %d", (int) new_value);

    return 0;
}

GOLIOTH_SETTINGS_HANDLER(LED, led_setting_cb);

int main(void)
{
    struct pouch_config config = {0};

    /* Load certificates for Pouch */
    int err = load_certificate(&config.certificate);
    if (err)
    {
        LOG_ERR("Failed to load certificate (err %d)", err);
        return 0;
    }

    config.private_key = load_private_key();
    if (config.private_key == PSA_KEY_ID_NULL)
    {
        LOG_ERR("Failed to load private key");
        return 0;
    }

    LOG_INF("Credentials loaded");

    err = pouch_init(&config);
    if (err)
    {
        LOG_ERR("Pouch init failed (err %d)", err);
        return 0;
    }

    /* Load certificates for HTTP mTLS transport */
    err = load_http_server_ca(CONFIG_EXAMPLE_HTTP_CLIENT_TLS_CREDENTIALS);
    if (err)
    {
        LOG_ERR("Failed to load server CA certificate (err %d)", err);
        return 0;
    }

    err = load_http_gw_device_crt(CONFIG_EXAMPLE_HTTP_CLIENT_TLS_CREDENTIALS);
    if (err)
    {
        LOG_ERR("Failed to load device certificate (err %d)", err);
        return 0;
    }

    err = load_http_gw_device_key(CONFIG_EXAMPLE_HTTP_CLIENT_TLS_CREDENTIALS);
    if (err)
    {
        LOG_ERR("Failed to load device key (err %d)", err);
        return 0;
    }

    err = pouch_http_client_init(CONFIG_EXAMPLE_HTTP_CLIENT_TLS_CREDENTIALS, K_FOREVER);
    if (0 != err)
    {
        LOG_ERR("Failed to initialize HTTP client transport");
        return err;
    }

    while (1)
    {
        /* Sync Pouch uplink and downlink */
        pouch_http_client_sync(K_NO_WAIT);

        k_sleep(K_SECONDS(CONFIG_EXAMPLE_HTTP_CLIENT_SYNC_PERIOD_S));
    }

    return err;
}
```

## src/conn_monitor.c
```c
/*
 * Copyright (c) 2026 Golioth
 *
 * SPDX-License-Identifier: Apache-2.0
 */

#include "zephyr/sys/atomic_types.h"
#include <zephyr/logging/log.h>
LOG_MODULE_REGISTER(conn_monitor, CONFIG_EXAMPLE_HTTP_CLIENT_LOG_LEVEL);

#include <zephyr/kernel.h>
#include <zephyr/net/net_mgmt.h>
#include <zephyr/net/conn_mgr_monitor.h>

static K_SEM_DEFINE(connected, 0, 1);

static atomic_t conn_flags;
#define CONNECTED_BIT BIT(0)

static void l4_event_handler(uint64_t event,
                             struct net_if *iface,
                             void *info,
                             size_t info_length,
                             void *user_data)
{
    switch (event)
    {
        case NET_EVENT_L4_CONNECTED:
            k_sem_give(&connected);
            atomic_set_bit(&conn_flags, CONNECTED_BIT);
            break;
        case NET_EVENT_L4_DISCONNECTED:
            k_sem_take(&connected, K_NO_WAIT);
            atomic_clear_bit(&conn_flags, CONNECTED_BIT);
            break;
        default:
            break;
    }
}

NET_MGMT_REGISTER_EVENT_HANDLER(l4_cb,
                                (NET_EVENT_L4_CONNECTED | NET_EVENT_L4_DISCONNECTED),
                                l4_event_handler,
                                NULL);

void wait_for_network(void)
{
    conn_mgr_mon_resend_status();
    LOG_INF("Waiting for network...");
    k_sem_take(&connected, K_FOREVER);
    LOG_INF("Network connected");
}

bool is_connected(void)
{
    return atomic_test_bit(&conn_flags, CONNECTED_BIT);
}
```

## src/credentials.c
```c
/*
 * Copyright (c) 2025 Golioth, Inc.
 *
 * SPDX-License-Identifier: Apache-2.0
 */
#include <stdlib.h>
#include <zephyr/fs/fs.h>
#include <pouch/pouch.h>
#include <mbedtls/pk.h>
#include <zephyr/net/tls_credentials.h>

#include <zephyr/logging/log.h>
LOG_MODULE_REGISTER(credentials);

#define CERT_DIR CONFIG_EXAMPLE_CREDENTIALS_DIR
#define TLS_CA_FILE CERT_DIR "/ca.der"
#define GW_CERT_FILE CERT_DIR "/" CONFIG_EXAMPLE_HTTP_CLIENT_GW_DEVICE_CRT_FILENAME
#define GW_KEY_FILE CERT_DIR "/" CONFIG_EXAMPLE_HTTP_CLIENT_GW_DEVICE_KEY_FILENAME
#define CERT_FILE CERT_DIR "/crt.der"
#define KEY_FILE CERT_DIR "/key.der"

struct mutual_tls_pki
{
    uint8_t *ca_cert;
    ssize_t ca_cert_len;
    uint8_t *gw_crt;
    ssize_t gw_crt_len;
    uint8_t *gw_key;
    ssize_t gw_key_len;
} _m_tls_ctx;

#ifndef CONFIG_EXAMPLE_HTTP_CLIENT_TLS_LOAD_CA_FROM_FILESYSTEM
static const uint8_t tls_ca_crt[] = {
#include "pouch-ca-crt.inc"
};
#endif  // CONFIG_EXAMPLE_HTTP_CLIENT_TLS_LOAD_CA_FROM_FILESYSTEM

static int psa_rng_for_mbedtls(void *p_rng, unsigned char *output, size_t output_len)
{
    return psa_generate_random(output, output_len);
}

/** Load the raw private key data into PSA */
static psa_key_id_t import_raw_pk(const uint8_t *private_key, size_t size)
{
    mbedtls_pk_context pk;
    mbedtls_pk_init(&pk);
    int err = mbedtls_pk_parse_key(&pk, private_key, size, NULL, 0, psa_rng_for_mbedtls, NULL);
    if (err)
    {
        LOG_ERR("Failed to parse key: -0x%x", -err);
        return PSA_KEY_ID_NULL;
    }

    psa_key_attributes_t attrs = PSA_KEY_ATTRIBUTES_INIT;

    psa_set_key_algorithm(&attrs, PSA_ALG_ECDH);
    psa_set_key_type(&attrs, PSA_KEY_TYPE_ECC_KEY_PAIR(PSA_ECC_FAMILY_SECP_R1));
    psa_set_key_usage_flags(&attrs, PSA_KEY_USAGE_DERIVE);

    psa_key_id_t key_id;
    err = mbedtls_pk_import_into_psa(&pk, &attrs, &key_id);
    if (err)
    {
        LOG_ERR("Failed to import private key: -0x%x", -err);
        return PSA_KEY_ID_NULL;
    }

    return key_id;
}

static void ensure_credentials_dir(void)
{
    struct fs_dirent dirent;

    int err = fs_stat(CERT_DIR, &dirent);
    if (err == -ENOENT)
    {
        err = fs_mkdir(CERT_DIR);
    }

    if (err)
    {
        LOG_ERR("Failed to create credentials dir: %d", err);
    }
}

static ssize_t get_file_size(const char *path)
{
    struct fs_dirent dirent;

    int err = fs_stat(path, &dirent);

    if (err < 0)
    {
        return err;
    }
    if (dirent.type != FS_DIR_ENTRY_FILE)
    {
        return -EISDIR;
    }

    return dirent.size;
}

static ssize_t read_file(const char *path, uint8_t **out)
{
    // Ensure that the credentials directory exists, so the user doesn't have to
    ensure_credentials_dir();

    ssize_t size = get_file_size(path);
    if (size <= 0)
    {
        return size;
    }

    uint8_t *buf = malloc(size);
    if (buf == NULL)
    {
        return -ENOMEM;
    }

    struct fs_file_t file;
    fs_file_t_init(&file);

    int err = fs_open(&file, path, FS_O_READ);
    if (err)
    {
        LOG_ERR("Could not open %s, err: %d", path, err);
        free(buf);
        return err;
    }

    size = fs_read(&file, buf, size);
    if (size < 0)
    {
        LOG_ERR("Could not read %s, err: %d", path, size);
        free(buf);
        goto finish;
    }

    LOG_DBG("Read %d bytes from %s", size, path);

    *out = buf;

finish:
    fs_close(&file);
    return size;
}

psa_key_id_t load_private_key(void)
{
    uint8_t *buf;
    ssize_t size = read_file(KEY_FILE, &buf);
    if (size < 0)
    {
        return PSA_KEY_ID_NULL;
    }

    psa_key_id_t key_id = import_raw_pk(buf, size);
    free(buf);
    return key_id;
}

int load_certificate(struct pouch_cert *cert)
{
    uint8_t *buf;
    ssize_t size = read_file(CERT_FILE, &buf);
    if (size < 0)
    {
        return size;
    }

    cert->buffer = buf;
    cert->size = size;

    LOG_DBG("Read certificate (%d bytes)", size);

    return 0;
}

void free_certificate(struct pouch_cert *cert)
{
    free((void *) cert->buffer);
}

ssize_t load_file_to_tls(char *fn, sec_tag_t sec_tag, enum tls_credential_type type, uint8_t **buf)
{
    ssize_t size = read_file(fn, buf);
    if (size < 0)
    {
        return size;
    }

    int err = tls_credential_add(sec_tag, type, *buf, size);
    return err;
}

int load_http_server_ca(sec_tag_t sec_tag)
{
#ifdef CONFIG_EXAMPLE_HTTP_CLIENT_TLS_LOAD_CA_FROM_FILESYSTEM
    if (NULL != _m_tls_ctx.ca_cert)
    {
        LOG_ERR("Free existing ca cert before loading");
        return -EEXIST;
    }

    _m_tls_ctx.ca_cert_len =
        load_file_to_tls(TLS_CA_FILE, sec_tag, TLS_CREDENTIAL_CA_CERTIFICATE, &_m_tls_ctx.ca_cert);
    return _m_tls_ctx.ca_cert_len;
#else
    return tls_credential_add(sec_tag,
                              TLS_CREDENTIAL_CA_CERTIFICATE,
                              tls_ca_crt,
                              sizeof(tls_ca_crt));
#endif
}

int load_http_gw_device_crt(sec_tag_t sec_tag)
{
    if (NULL != _m_tls_ctx.gw_crt)
    {
        LOG_ERR("Free existing gw cert before loading");
        return -EEXIST;
    }

    _m_tls_ctx.gw_crt_len = load_file_to_tls(GW_CERT_FILE,
                                             sec_tag,
                                             TLS_CREDENTIAL_PUBLIC_CERTIFICATE,
                                             &_m_tls_ctx.gw_crt);
    return _m_tls_ctx.gw_crt_len;
}

int load_http_gw_device_key(sec_tag_t sec_tag)
{
    if (NULL != _m_tls_ctx.gw_key)
    {
        LOG_ERR("Free existing gw key before loading");
        return -EEXIST;
    }

    _m_tls_ctx.gw_key_len =
        load_file_to_tls(GW_KEY_FILE, sec_tag, TLS_CREDENTIAL_PRIVATE_KEY, &_m_tls_ctx.gw_key);
    return _m_tls_ctx.gw_key_len;
}

void free_http_certs(void)
{
#ifdef CONFIG_EXAMPLE_HTTP_CLIENT_TLS_LOAD_CA_FROM_FILESYSTEM
    free(_m_tls_ctx.ca_cert);
#endif
    _m_tls_ctx.ca_cert = NULL;
    _m_tls_ctx.ca_cert_len = 0;

    free(_m_tls_ctx.gw_crt);
    _m_tls_ctx.gw_crt = NULL;
    _m_tls_ctx.gw_crt_len = 0;

    free(_m_tls_ctx.gw_key);
    _m_tls_ctx.gw_key = NULL;
    _m_tls_ctx.gw_key_len = 0;
}
```

## src/fw_update_test.c
```c
/*
 * Copyright (c) 2026 Golioth
 *
 * SPDX-License-Identifier: Apache-2.0
 */

#include <zephyr/logging/log.h>
LOG_MODULE_REGISTER(fw_update_test);

#include <stdio.h>
#include <zephyr/kernel.h>
#include <zephyr/app_version.h>
#include <psa/crypto.h>

#include <pouch/golioth/ota.h>

static void log_sha256(const char *name, const uint8_t hash[32])
{
    char hex[65];

    for (int i = 0; i < 32; i++)
    {
        snprintf(&hex[i * 2], 3, "%02x", hash[i]);
    }

    LOG_INF("OTA %s SHA256: %s", name, hex);
}

static psa_hash_operation_t hash_op;
static size_t total_received;

static void ota_main_receive(const void *data, size_t offset, size_t len, bool is_last)
{
    psa_status_t status;

    if (0 == offset)
    {
        hash_op = psa_hash_operation_init();
        status = psa_hash_setup(&hash_op, PSA_ALG_SHA_256);
        if (PSA_SUCCESS != status)
        {
            LOG_ERR("Failed to init SHA256: %d", status);
            return;
        }
        total_received = 0;
    }

    status = psa_hash_update(&hash_op, data, len);
    if (PSA_SUCCESS != status)
    {
        LOG_ERR("Failed to update SHA256: %d", status);
        return;
    }

    total_received += len;

    if (is_last)
    {
        uint8_t hash[32];
        size_t hash_len;

        status = psa_hash_finish(&hash_op, hash, sizeof(hash), &hash_len);
        if (PSA_SUCCESS != status)
        {
            LOG_ERR("Failed to finish SHA256: %d", status);
            return;
        }

        LOG_INF("OTA download complete: %zu bytes", total_received);
        log_sha256("computed", hash);

        golioth_ota_mark_idle("main");
    }
}

static void ota_manifest_receive(const struct golioth_ota_manifest_component *components,
                                 size_t num_components)
{
    for (int i = 0; i < num_components; i++)
    {
        LOG_INF("OTA manifest: %s current=%s target=%s size=%d",
                components[i].name,
                components[i].current,
                components[i].target,
                components[i].size);

        log_sha256("manifest", components[i].target_hash);

        if (0 != strcmp(components[i].current, components[i].target))
        {
            LOG_INF("Marking %s for download", components[i].name);
            golioth_ota_mark_for_download(components[i].name);
        }
    }
}

GOLIOTH_OTA_COMPONENT(main, "main", APP_VERSION_STRING, ota_main_receive);
GOLIOTH_OTA_MANIFEST_HANDLER(ota_manifest_receive);
```
