## CMakeLists.txt
```
# Copyright (c) 2025 Golioth, Inc.
#
# SPDX-License-Identifier: Apache-2.0

cmake_minimum_required(VERSION 3.20.0)

find_package(Zephyr REQUIRED HINTS $ENV{ZEPHYR_BASE})
project(cert_example)

target_link_libraries(mbedTLS)

zephyr_include_directories(${CMAKE_CURRENT_LIST_DIR}/)

target_sources(app PRIVATE
  src/main.c
)
```

## Kconfig
```
# Copyright (c) 2025 Golioth, Inc.
#
# SPDX-License-Identifier: Apache-2.0

source "$ZEPHYR_BASE/Kconfig"
```

## prj.conf
```kconfig
# Copyright (c) 2025 Golioth, Inc.
#
# SPDX-License-Identifier: Apache-2.0

#CONFIG_MBEDTLS_HEAP_SIZE=1536
CONFIG_MBEDTLS_HEAP_SIZE=4096
CONFIG_MAIN_STACK_SIZE=4096

CONFIG_LOG=y
CONFIG_REBOOT=y
CONFIG_SHELL=y
CONFIG_UART_CONSOLE=y

CONFIG_PSA_WANT_ECC_SECP_R1_384=y

CONFIG_MBEDTLS=y
CONFIG_MBEDTLS_PSA_CRYPTO_C=y

CONFIG_PSA_WANT_ALG_ECDSA=y
CONFIG_PSA_WANT_ALG_ECDH=y
CONFIG_PSA_WANT_ALG_HKDF=y
CONFIG_PSA_WANT_ALG_HMAC=y
CONFIG_PSA_WANT_ALG_STREAM_CIPHER=y
CONFIG_PSA_WANT_ALG_SHA_256=y
CONFIG_PSA_WANT_ALG_SHA_384=y
CONFIG_PSA_WANT_ECC_SECP_R1_256=y
CONFIG_PSA_WANT_ECC_SECP_R1_384=y
CONFIG_PSA_WANT_KEY_TYPE_ECC_KEY_PAIR_DERIVE=y
CONFIG_PSA_WANT_KEY_TYPE_ECC_PUBLIC_KEY=y
CONFIG_MBEDTLS_ECDSA_C=y
CONFIG_MBEDTLS_ECP_C=y
CONFIG_BASE64=y

CONFIG_MBEDTLS_USER_CONFIG_ENABLE=y
CONFIG_MBEDTLS_USER_CONFIG_FILE="mbedtls_config.h"
```

## src/main.c
```c
#include <zephyr/kernel.h>
#include <zephyr/logging/log.h>
LOG_MODULE_REGISTER(main, LOG_LEVEL_DBG);
#include <mbedtls/x509_crt.h>

static const uint8_t raw_ca_cert[] = {
    0x30, 0x82, 0x02, 0x20, 0x30, 0x82, 0x01, 0xa6, 0xa0, 0x03, 0x02, 0x01, 0x02, 0x02, 0x14, 0x00,
    0xee, 0x8f, 0xa6, 0x20, 0xf7, 0xc9, 0x48, 0x62, 0x79, 0x76, 0x17, 0xa8, 0x94, 0x3f, 0xf4, 0x3b,
    0xe7, 0x28, 0x7d, 0x30, 0x0a, 0x06, 0x08, 0x2a, 0x86, 0x48, 0xce, 0x3d, 0x04, 0x03, 0x03, 0x30,
    0x3f, 0x31, 0x0b, 0x30, 0x09, 0x06, 0x03, 0x55, 0x04, 0x06, 0x13, 0x02, 0x55, 0x53, 0x31, 0x16,
    0x30, 0x14, 0x06, 0x03, 0x55, 0x04, 0x0a, 0x13, 0x0d, 0x47, 0x6f, 0x6c, 0x69, 0x6f, 0x74, 0x68,
    0x2c, 0x20, 0x49, 0x6e, 0x63, 0x2e, 0x31, 0x18, 0x30, 0x16, 0x06, 0x03, 0x55, 0x04, 0x03, 0x13,
    0x0f, 0x47, 0x6f, 0x6c, 0x69, 0x6f, 0x74, 0x68, 0x20, 0x52, 0x6f, 0x6f, 0x74, 0x20, 0x58, 0x31,
    0x30, 0x1e, 0x17, 0x0d, 0x32, 0x34, 0x31, 0x31, 0x31, 0x39, 0x31, 0x35, 0x35, 0x32, 0x33, 0x34,
    0x5a, 0x17, 0x0d, 0x34, 0x34, 0x31, 0x31, 0x31, 0x34, 0x31, 0x35, 0x35, 0x32, 0x33, 0x33, 0x5a,
    0x30, 0x3f, 0x31, 0x0b, 0x30, 0x09, 0x06, 0x03, 0x55, 0x04, 0x06, 0x13, 0x02, 0x55, 0x53, 0x31,
    0x16, 0x30, 0x14, 0x06, 0x03, 0x55, 0x04, 0x0a, 0x13, 0x0d, 0x47, 0x6f, 0x6c, 0x69, 0x6f, 0x74,
    0x68, 0x2c, 0x20, 0x49, 0x6e, 0x63, 0x2e, 0x31, 0x18, 0x30, 0x16, 0x06, 0x03, 0x55, 0x04, 0x03,
    0x13, 0x0f, 0x47, 0x6f, 0x6c, 0x69, 0x6f, 0x74, 0x68, 0x20, 0x52, 0x6f, 0x6f, 0x74, 0x20, 0x58,
    0x31, 0x30, 0x76, 0x30, 0x10, 0x06, 0x07, 0x2a, 0x86, 0x48, 0xce, 0x3d, 0x02, 0x01, 0x06, 0x05,
    0x2b, 0x81, 0x04, 0x00, 0x22, 0x03, 0x62, 0x00, 0x04, 0x4a, 0xef, 0x46, 0x8e, 0x85, 0xe6, 0x6b,
    0xb7, 0xa0, 0xed, 0x0d, 0x8e, 0x8b, 0x73, 0x74, 0x29, 0xa6, 0x7f, 0xc1, 0xce, 0xeb, 0xc1, 0xce,
    0x17, 0x48, 0x0d, 0x84, 0xa5, 0x53, 0x2b, 0x47, 0xe0, 0xfa, 0xfc, 0xca, 0xe1, 0x58, 0x6c, 0xe7,
    0x2c, 0xcf, 0x2b, 0xb6, 0x8a, 0x58, 0xa3, 0xb0, 0x37, 0x2d, 0xb2, 0x0f, 0x15, 0x16, 0x28, 0x14,
    0xf7, 0xc8, 0x81, 0xef, 0xfb, 0x1a, 0xf9, 0x41, 0x34, 0xba, 0x61, 0x3d, 0x64, 0xb8, 0xca, 0x68,
    0xfc, 0xfc, 0xa9, 0x9c, 0xdd, 0x0c, 0x99, 0xb9, 0x81, 0x25, 0x5f, 0x7a, 0x78, 0xde, 0xf5, 0x8f,
    0x2e, 0x58, 0xf8, 0x46, 0x3b, 0x58, 0xc9, 0xf8, 0x34, 0xa3, 0x63, 0x30, 0x61, 0x30, 0x0e, 0x06,
    0x03, 0x55, 0x1d, 0x0f, 0x01, 0x01, 0xff, 0x04, 0x04, 0x03, 0x02, 0x01, 0x06, 0x30, 0x0f, 0x06,
    0x03, 0x55, 0x1d, 0x13, 0x01, 0x01, 0xff, 0x04, 0x05, 0x30, 0x03, 0x01, 0x01, 0xff, 0x30, 0x1d,
    0x06, 0x03, 0x55, 0x1d, 0x0e, 0x04, 0x16, 0x04, 0x14, 0xce, 0x8e, 0xbc, 0x09, 0x52, 0xd8, 0x98,
    0xc1, 0x23, 0xe0, 0x08, 0x3d, 0x44, 0x00, 0x06, 0x45, 0x71, 0x5d, 0x56, 0xf1, 0x30, 0x1f, 0x06,
    0x03, 0x55, 0x1d, 0x23, 0x04, 0x18, 0x30, 0x16, 0x80, 0x14, 0xce, 0x8e, 0xbc, 0x09, 0x52, 0xd8,
    0x98, 0xc1, 0x23, 0xe0, 0x08, 0x3d, 0x44, 0x00, 0x06, 0x45, 0x71, 0x5d, 0x56, 0xf1, 0x30, 0x0a,
    0x06, 0x08, 0x2a, 0x86, 0x48, 0xce, 0x3d, 0x04, 0x03, 0x03, 0x03, 0x68, 0x00, 0x30, 0x65, 0x02,
    0x30, 0x7d, 0x2d, 0xc2, 0xf7, 0x1f, 0x5b, 0x0a, 0x53, 0xa8, 0x51, 0xae, 0x0a, 0x99, 0x54, 0xe8,
    0x51, 0x2a, 0x0a, 0xa9, 0x47, 0x7f, 0x24, 0x56, 0x6c, 0x60, 0x42, 0xe2, 0x6c, 0x93, 0x53, 0x77,
    0xe6, 0xf5, 0x4d, 0x75, 0xff, 0xb7, 0x83, 0x83, 0x67, 0x9c, 0x4b, 0x95, 0x22, 0x4d, 0xd5, 0xa4,
    0x02, 0x02, 0x31, 0x00, 0xa4, 0x99, 0xfd, 0x4e, 0x9a, 0xd3, 0x32, 0x08, 0x03, 0xd0, 0x75, 0x35,
    0x3e, 0x33, 0x02, 0xe9, 0xcc, 0x80, 0x58, 0x1b, 0xfd, 0xd2, 0xc9, 0x95, 0x33, 0xb0, 0xc1, 0xc0,
    0x1e, 0xf4, 0x4f, 0x28, 0x6a, 0x40, 0x63, 0xed, 0x1e, 0x8d, 0xf2, 0x9a, 0x2d, 0x52, 0x57, 0x42,
    0x6b, 0x31, 0x07, 0x83

};

static const uint8_t raw_cert_chain[] = {
    0x2d, 0x2d, 0x2d, 0x2d, 0x2d, 0x42, 0x45, 0x47, 0x49, 0x4e, 0x20, 0x43, 0x45, 0x52, 0x54, 0x49,
    0x46, 0x49, 0x43, 0x41, 0x54, 0x45, 0x2d, 0x2d, 0x2d, 0x2d, 0x2d, 0x0a, 0x4d, 0x49, 0x49, 0x42,
    0x31, 0x6a, 0x43, 0x43, 0x41, 0x56, 0x79, 0x67, 0x41, 0x77, 0x49, 0x42, 0x41, 0x67, 0x49, 0x55,
    0x41, 0x4c, 0x46, 0x69, 0x44, 0x50, 0x31, 0x6e, 0x72, 0x31, 0x39, 0x76, 0x39, 0x44, 0x68, 0x4e,
    0x35, 0x65, 0x48, 0x66, 0x6f, 0x58, 0x2f, 0x4b, 0x62, 0x36, 0x6f, 0x77, 0x43, 0x67, 0x59, 0x49,
    0x4b, 0x6f, 0x5a, 0x49, 0x7a, 0x6a, 0x30, 0x45, 0x41, 0x77, 0x4d, 0x77, 0x0a, 0x4d, 0x6a, 0x45,
    0x4c, 0x4d, 0x41, 0x6b, 0x47, 0x41, 0x31, 0x55, 0x45, 0x42, 0x68, 0x4d, 0x43, 0x56, 0x56, 0x4d,
    0x78, 0x46, 0x6a, 0x41, 0x55, 0x42, 0x67, 0x4e, 0x56, 0x42, 0x41, 0x6f, 0x54, 0x44, 0x55, 0x64,
    0x76, 0x62, 0x47, 0x6c, 0x76, 0x64, 0x47, 0x67, 0x73, 0x49, 0x45, 0x6c, 0x75, 0x59, 0x79, 0x34,
    0x78, 0x43, 0x7a, 0x41, 0x4a, 0x42, 0x67, 0x4e, 0x56, 0x42, 0x41, 0x4d, 0x54, 0x0a, 0x41, 0x6b,
    0x55, 0x78, 0x4d, 0x42, 0x34, 0x58, 0x44, 0x54, 0x49, 0x31, 0x4d, 0x44, 0x67, 0x78, 0x4f, 0x44,
    0x45, 0x35, 0x4d, 0x54, 0x55, 0x31, 0x4e, 0x56, 0x6f, 0x58, 0x44, 0x54, 0x49, 0x31, 0x4d, 0x44,
    0x6b, 0x78, 0x4e, 0x7a, 0x45, 0x35, 0x4d, 0x54, 0x55, 0x31, 0x4e, 0x46, 0x6f, 0x77, 0x41, 0x44,
    0x42, 0x5a, 0x4d, 0x42, 0x4d, 0x47, 0x42, 0x79, 0x71, 0x47, 0x53, 0x4d, 0x34, 0x39, 0x0a, 0x41,
    0x67, 0x45, 0x47, 0x43, 0x43, 0x71, 0x47, 0x53, 0x4d, 0x34, 0x39, 0x41, 0x77, 0x45, 0x48, 0x41,
    0x30, 0x49, 0x41, 0x42, 0x46, 0x78, 0x43, 0x74, 0x57, 0x5a, 0x63, 0x37, 0x41, 0x4b, 0x68, 0x67,
    0x73, 0x53, 0x70, 0x74, 0x74, 0x36, 0x4b, 0x53, 0x7a, 0x62, 0x45, 0x59, 0x31, 0x57, 0x31, 0x42,
    0x75, 0x4b, 0x5a, 0x65, 0x70, 0x70, 0x75, 0x35, 0x42, 0x49, 0x6a, 0x59, 0x33, 0x30, 0x62, 0x0a,
    0x65, 0x43, 0x62, 0x47, 0x4e, 0x36, 0x2f, 0x5a, 0x58, 0x75, 0x50, 0x50, 0x30, 0x4e, 0x63, 0x79,
    0x7a, 0x62, 0x6b, 0x4f, 0x45, 0x57, 0x30, 0x65, 0x42, 0x50, 0x4e, 0x31, 0x77, 0x56, 0x67, 0x38,
    0x38, 0x57, 0x58, 0x5a, 0x45, 0x41, 0x5a, 0x54, 0x6e, 0x66, 0x47, 0x6a, 0x67, 0x59, 0x45, 0x77,
    0x66, 0x7a, 0x41, 0x4f, 0x42, 0x67, 0x4e, 0x56, 0x48, 0x51, 0x38, 0x42, 0x41, 0x66, 0x38, 0x45,
    0x0a, 0x42, 0x41, 0x4d, 0x43, 0x42, 0x61, 0x41, 0x77, 0x44, 0x41, 0x59, 0x44, 0x56, 0x52, 0x30,
    0x54, 0x41, 0x51, 0x48, 0x2f, 0x42, 0x41, 0x49, 0x77, 0x41, 0x44, 0x41, 0x64, 0x42, 0x67, 0x4e,
    0x56, 0x48, 0x51, 0x34, 0x45, 0x46, 0x67, 0x51, 0x55, 0x63, 0x72, 0x2f, 0x76, 0x4d, 0x4b, 0x33,
    0x55, 0x38, 0x50, 0x2b, 0x48, 0x4f, 0x68, 0x58, 0x77, 0x53, 0x5a, 0x66, 0x2b, 0x54, 0x58, 0x49,
    0x38, 0x0a, 0x6b, 0x76, 0x6f, 0x77, 0x48, 0x77, 0x59, 0x44, 0x56, 0x52, 0x30, 0x6a, 0x42, 0x42,
    0x67, 0x77, 0x46, 0x6f, 0x41, 0x55, 0x57, 0x6b, 0x75, 0x79, 0x30, 0x68, 0x64, 0x38, 0x49, 0x67,
    0x53, 0x38, 0x5a, 0x71, 0x64, 0x58, 0x62, 0x7a, 0x48, 0x77, 0x6b, 0x6c, 0x78, 0x6a, 0x7a, 0x5a,
    0x30, 0x77, 0x48, 0x77, 0x59, 0x44, 0x56, 0x52, 0x30, 0x52, 0x41, 0x51, 0x48, 0x2f, 0x42, 0x42,
    0x55, 0x77, 0x0a, 0x45, 0x34, 0x49, 0x52, 0x63, 0x47, 0x39, 0x31, 0x59, 0x32, 0x67, 0x75, 0x5a,
    0x32, 0x39, 0x70, 0x61, 0x57, 0x39, 0x30, 0x61, 0x43, 0x35, 0x6b, 0x5a, 0x58, 0x59, 0x77, 0x43,
    0x67, 0x59, 0x49, 0x4b, 0x6f, 0x5a, 0x49, 0x7a, 0x6a, 0x30, 0x45, 0x41, 0x77, 0x4d, 0x44, 0x61,
    0x41, 0x41, 0x77, 0x5a, 0x51, 0x49, 0x78, 0x41, 0x50, 0x6f, 0x5a, 0x75, 0x2b, 0x33, 0x48, 0x4d,
    0x42, 0x57, 0x65, 0x0a, 0x67, 0x32, 0x76, 0x50, 0x6b, 0x77, 0x37, 0x65, 0x30, 0x51, 0x4f, 0x30,
    0x59, 0x63, 0x54, 0x4a, 0x46, 0x37, 0x77, 0x61, 0x77, 0x74, 0x55, 0x33, 0x6c, 0x4b, 0x47, 0x6c,
    0x78, 0x47, 0x39, 0x7a, 0x38, 0x6a, 0x6c, 0x56, 0x42, 0x7a, 0x70, 0x30, 0x48, 0x56, 0x41, 0x79,
    0x52, 0x42, 0x69, 0x73, 0x70, 0x73, 0x4c, 0x70, 0x41, 0x67, 0x49, 0x77, 0x47, 0x54, 0x6c, 0x54,
    0x4b, 0x63, 0x67, 0x38, 0x0a, 0x39, 0x72, 0x54, 0x71, 0x50, 0x49, 0x46, 0x6f, 0x4f, 0x73, 0x58,
    0x4f, 0x6d, 0x62, 0x42, 0x4d, 0x4f, 0x61, 0x48, 0x66, 0x41, 0x4d, 0x30, 0x6f, 0x35, 0x4c, 0x43,
    0x65, 0x70, 0x52, 0x48, 0x70, 0x30, 0x69, 0x44, 0x53, 0x37, 0x45, 0x4e, 0x72, 0x6a, 0x38, 0x34,
    0x2f, 0x32, 0x4d, 0x38, 0x49, 0x4a, 0x50, 0x77, 0x7a, 0x54, 0x65, 0x6d, 0x63, 0x0a, 0x2d, 0x2d,
    0x2d, 0x2d, 0x2d, 0x45, 0x4e, 0x44, 0x20, 0x43, 0x45, 0x52, 0x54, 0x49, 0x46, 0x49, 0x43, 0x41,
    0x54, 0x45, 0x2d, 0x2d, 0x2d, 0x2d, 0x2d, 0x0a, 0x2d, 0x2d, 0x2d, 0x2d, 0x2d, 0x42, 0x45, 0x47,
    0x49, 0x4e, 0x20, 0x43, 0x45, 0x52, 0x54, 0x49, 0x46, 0x49, 0x43, 0x41, 0x54, 0x45, 0x2d, 0x2d,
    0x2d, 0x2d, 0x2d, 0x0a, 0x4d, 0x49, 0x49, 0x43, 0x46, 0x7a, 0x43, 0x43, 0x41, 0x5a, 0x79, 0x67,
    0x41, 0x77, 0x49, 0x42, 0x41, 0x67, 0x49, 0x55, 0x41, 0x49, 0x55, 0x6c, 0x68, 0x38, 0x65, 0x69,
    0x37, 0x36, 0x33, 0x46, 0x72, 0x55, 0x75, 0x65, 0x59, 0x64, 0x48, 0x44, 0x59, 0x41, 0x33, 0x54,
    0x67, 0x45, 0x59, 0x77, 0x43, 0x67, 0x59, 0x49, 0x4b, 0x6f, 0x5a, 0x49, 0x7a, 0x6a, 0x30, 0x45,
    0x41, 0x77, 0x4d, 0x77, 0x0a, 0x50, 0x7a, 0x45, 0x4c, 0x4d, 0x41, 0x6b, 0x47, 0x41, 0x31, 0x55,
    0x45, 0x42, 0x68, 0x4d, 0x43, 0x56, 0x56, 0x4d, 0x78, 0x46, 0x6a, 0x41, 0x55, 0x42, 0x67, 0x4e,
    0x56, 0x42, 0x41, 0x6f, 0x54, 0x44, 0x55, 0x64, 0x76, 0x62, 0x47, 0x6c, 0x76, 0x64, 0x47, 0x67,
    0x73, 0x49, 0x45, 0x6c, 0x75, 0x59, 0x79, 0x34, 0x78, 0x47, 0x44, 0x41, 0x57, 0x42, 0x67, 0x4e,
    0x56, 0x42, 0x41, 0x4d, 0x54, 0x0a, 0x44, 0x30, 0x64, 0x76, 0x62, 0x47, 0x6c, 0x76, 0x64, 0x47,
    0x67, 0x67, 0x55, 0x6d, 0x39, 0x76, 0x64, 0x43, 0x42, 0x59, 0x4d, 0x54, 0x41, 0x65, 0x46, 0x77,
    0x30, 0x79, 0x4e, 0x54, 0x41, 0x34, 0x4d, 0x54, 0x67, 0x78, 0x4f, 0x44, 0x41, 0x30, 0x4d, 0x54,
    0x4e, 0x61, 0x46, 0x77, 0x30, 0x79, 0x4f, 0x44, 0x41, 0x34, 0x4d, 0x54, 0x63, 0x78, 0x4f, 0x44,
    0x41, 0x30, 0x4d, 0x54, 0x4a, 0x61, 0x0a, 0x4d, 0x44, 0x49, 0x78, 0x43, 0x7a, 0x41, 0x4a, 0x42,
    0x67, 0x4e, 0x56, 0x42, 0x41, 0x59, 0x54, 0x41, 0x6c, 0x56, 0x54, 0x4d, 0x52, 0x59, 0x77, 0x46,
    0x41, 0x59, 0x44, 0x56, 0x51, 0x51, 0x4b, 0x45, 0x77, 0x31, 0x48, 0x62, 0x32, 0x78, 0x70, 0x62,
    0x33, 0x52, 0x6f, 0x4c, 0x43, 0x42, 0x4a, 0x62, 0x6d, 0x4d, 0x75, 0x4d, 0x51, 0x73, 0x77, 0x43,
    0x51, 0x59, 0x44, 0x56, 0x51, 0x51, 0x44, 0x0a, 0x45, 0x77, 0x4a, 0x46, 0x4d, 0x54, 0x42, 0x32,
    0x4d, 0x42, 0x41, 0x47, 0x42, 0x79, 0x71, 0x47, 0x53, 0x4d, 0x34, 0x39, 0x41, 0x67, 0x45, 0x47,
    0x42, 0x53, 0x75, 0x42, 0x42, 0x41, 0x41, 0x69, 0x41, 0x32, 0x49, 0x41, 0x42, 0x47, 0x4e, 0x7a,
    0x48, 0x77, 0x4a, 0x70, 0x77, 0x66, 0x67, 0x39, 0x49, 0x4e, 0x4f, 0x53, 0x72, 0x36, 0x4f, 0x59,
    0x35, 0x47, 0x4a, 0x4e, 0x38, 0x30, 0x59, 0x45, 0x0a, 0x43, 0x4f, 0x64, 0x70, 0x78, 0x79, 0x52,
    0x30, 0x78, 0x76, 0x39, 0x4a, 0x33, 0x71, 0x34, 0x61, 0x64, 0x65, 0x73, 0x48, 0x55, 0x78, 0x64,
    0x4b, 0x67, 0x58, 0x4b, 0x5a, 0x38, 0x79, 0x43, 0x41, 0x38, 0x4d, 0x54, 0x59, 0x6a, 0x72, 0x54,
    0x37, 0x2f, 0x64, 0x79, 0x4b, 0x71, 0x36, 0x72, 0x4c, 0x74, 0x2f, 0x4a, 0x59, 0x4c, 0x48, 0x39,
    0x47, 0x50, 0x36, 0x67, 0x41, 0x59, 0x64, 0x48, 0x4b, 0x0a, 0x38, 0x74, 0x45, 0x50, 0x63, 0x59,
    0x6e, 0x4d, 0x79, 0x6a, 0x35, 0x53, 0x33, 0x4a, 0x72, 0x6a, 0x4a, 0x76, 0x34, 0x53, 0x77, 0x62,
    0x4b, 0x48, 0x5a, 0x74, 0x79, 0x33, 0x63, 0x72, 0x64, 0x4d, 0x49, 0x49, 0x64, 0x45, 0x75, 0x61,
    0x4e, 0x6d, 0x4d, 0x47, 0x51, 0x77, 0x44, 0x67, 0x59, 0x44, 0x56, 0x52, 0x30, 0x50, 0x41, 0x51,
    0x48, 0x2f, 0x42, 0x41, 0x51, 0x44, 0x41, 0x67, 0x45, 0x47, 0x0a, 0x4d, 0x42, 0x49, 0x47, 0x41,
    0x31, 0x55, 0x64, 0x45, 0x77, 0x45, 0x42, 0x2f, 0x77, 0x51, 0x49, 0x4d, 0x41, 0x59, 0x42, 0x41,
    0x66, 0x38, 0x43, 0x41, 0x51, 0x41, 0x77, 0x48, 0x51, 0x59, 0x44, 0x56, 0x52, 0x30, 0x4f, 0x42,
    0x42, 0x59, 0x45, 0x46, 0x46, 0x70, 0x4c, 0x73, 0x74, 0x49, 0x58, 0x66, 0x43, 0x49, 0x45, 0x76,
    0x47, 0x61, 0x6e, 0x56, 0x32, 0x38, 0x78, 0x38, 0x4a, 0x4a, 0x63, 0x0a, 0x59, 0x38, 0x32, 0x64,
    0x4d, 0x42, 0x38, 0x47, 0x41, 0x31, 0x55, 0x64, 0x49, 0x77, 0x51, 0x59, 0x4d, 0x42, 0x61, 0x41,
    0x46, 0x4d, 0x36, 0x4f, 0x76, 0x41, 0x6c, 0x53, 0x32, 0x4a, 0x6a, 0x42, 0x49, 0x2b, 0x41, 0x49,
    0x50, 0x55, 0x51, 0x41, 0x42, 0x6b, 0x56, 0x78, 0x58, 0x56, 0x62, 0x78, 0x4d, 0x41, 0x6f, 0x47,
    0x43, 0x43, 0x71, 0x47, 0x53, 0x4d, 0x34, 0x39, 0x42, 0x41, 0x4d, 0x44, 0x0a, 0x41, 0x32, 0x6b,
    0x41, 0x4d, 0x47, 0x59, 0x43, 0x4d, 0x51, 0x43, 0x42, 0x69, 0x47, 0x76, 0x53, 0x47, 0x4c, 0x64,
    0x58, 0x6a, 0x38, 0x2b, 0x51, 0x74, 0x41, 0x61, 0x32, 0x35, 0x59, 0x31, 0x72, 0x42, 0x5a, 0x64,
    0x6d, 0x44, 0x6c, 0x4f, 0x4d, 0x67, 0x2f, 0x34, 0x62, 0x7a, 0x61, 0x4f, 0x55, 0x69, 0x70, 0x4f,
    0x47, 0x46, 0x2b, 0x7a, 0x69, 0x42, 0x30, 0x74, 0x54, 0x50, 0x67, 0x4c, 0x72, 0x0a, 0x41, 0x31,
    0x32, 0x4a, 0x43, 0x6c, 0x45, 0x30, 0x51, 0x74, 0x6f, 0x43, 0x4d, 0x51, 0x44, 0x33, 0x39, 0x49,
    0x5a, 0x35, 0x6a, 0x49, 0x35, 0x61, 0x50, 0x38, 0x35, 0x71, 0x70, 0x76, 0x4b, 0x4c, 0x6d, 0x34,
    0x66, 0x4c, 0x56, 0x78, 0x4c, 0x4d, 0x78, 0x34, 0x73, 0x71, 0x38, 0x50, 0x6c, 0x2b, 0x71, 0x67,
    0x44, 0x66, 0x70, 0x37, 0x44, 0x53, 0x58, 0x62, 0x41, 0x43, 0x4f, 0x42, 0x75, 0x49, 0x0a, 0x64,
    0x4f, 0x53, 0x35, 0x45, 0x5a, 0x4a, 0x6a, 0x38, 0x6c, 0x51, 0x56, 0x5a, 0x54, 0x77, 0x3d, 0x0a,
    0x2d, 0x2d, 0x2d, 0x2d, 0x2d, 0x45, 0x4e, 0x44, 0x20, 0x43, 0x45, 0x52, 0x54, 0x49, 0x46, 0x49,
    0x43, 0x41, 0x54, 0x45, 0x2d, 0x2d, 0x2d, 0x2d, 0x2d, 0x00};

int main(void)
{
    LOG_INF("Starting sample!");

    mbedtls_x509_crt ca_cert;

    mbedtls_x509_crt_init(&ca_cert);
    int ret = mbedtls_x509_crt_parse(&ca_cert, raw_ca_cert, sizeof(raw_ca_cert));

    if (ret != 0)
    {
        LOG_ERR("failed to parse CA cert");
        return -1;
    }
    mbedtls_x509_crt cert_chain;
    mbedtls_x509_crt_init(&cert_chain);
    ret = mbedtls_x509_crt_parse(&cert_chain, raw_cert_chain, sizeof(raw_cert_chain));

    if (ret != 0)
    {
        LOG_ERR("failed to parse cert chain");
        return -1;
    }

    uint32_t flags;
    ret = mbedtls_x509_crt_verify(&cert_chain, &ca_cert, NULL, NULL, &flags, NULL, NULL);
    if (ret != 0)
    {
        LOG_ERR("Failed verifying server cert: 0x%x", -ret);
        return -EPERM;
    }

    LOG_INF("Successfully verified!");
    return 0;
}
```
