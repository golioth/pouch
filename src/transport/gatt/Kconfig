## src/transport/gatt/Kconfig
```kconfig
# Copyright (c) 2025 Golioth, Inc.
#
# SPDX-License-Identifier: Apache-2.0

config POUCH_TRANSPORT_GATT_CUD_ATTRIBUTES
    bool "Include CUD attributes for each characteristic"
    help
        If enabled, Characteristic User Description attributes will
        be added for each characteristic with a brief identifier. This
        can be useful during debugging and development to identify
        the characteristics without consulting their UUIDs.

choice POUCH_TRANSPORT_GATT_PERM
	bool "GATT permissions"

config POUCH_TRANSPORT_GATT_PERM_LESC
	bool "Require LE Secure Connection for access"

config POUCH_TRANSPORT_GATT_PERM_AUTHEN
	bool "Require authentication for access"

endchoice # POUCH_TRANSPORT_GATT_PERM

config POUCH_GATT_DOWNLINK_WINDOW_SIZE
    int "Pouch GATT downlink window size"
    range 1 127
    default 4
    help
        The number of unacknowledged packets that can be received by
        the device on the downlink characteristic. Larger numbers can
        increase throughput but will use more RAM.

config POUCH_GATT_SERVER_CERT_WINDOW_SIZE
    int "Pouch GATT server certificate window size"
    range 1 127
    default 4
    help
        The number of unacknowledged packets that can be received by
        the device on the server certificate characteristic. Larger
        numbers can increase throughput but will use more RAM.

module = POUCH_GATT
module-str = Pouch GATT
source "subsys/logging/Kconfig.template.log_config"
```

## src/transport/http/Kconfig
```kconfig
# Copyright (c) 2026 Golioth, Inc.
#
# SPDX-License-Identifier: Apache-2.0

config POUCH_HTTP_GW_URI
    string "Pouch gateway address"
    default "gw.golioth.io"
    help
        URI address of the HTTP gateway

config POUCH_HTTP_GW_PORT
    string "Pouch gateway port"
    default "443"
    help
        Port to use for the HTTP gateway

config POUCH_HTTP_TIMEOUT_S
    int "Pouch HTTP timeout (seconds)"
    default 10
    help
        Timeout for HTTP requests

config POUCH_HTTP_RCV_BUF_SIZE
    int "HTTP receive buffer size"
    default 1024
    help
        Buffer size used to store response from server

config POUCH_HTTP_SCRATCH_BUF_SIZE
    int "HTTP upload scratch buffer size"
    default 1024
    help
        Size of the scratch buffer used for storing chunks during uplink

config POUCH_HTTP_SERVER_CRT_MAX_SIZE
    int "HTTP server cert storage size"
    default 4096
    help
        Amount of memory to allocate for storing the downloaded gateway certificate

module = POUCH_HTTP
module-str = Pouch HTTP
source "subsys/logging/Kconfig.template.log_config"
```

## tests/esp_idf/port/sdkconfig.defaults
```kconfig
CONFIG_POUCH=y
CONFIG_POUCH_DELAYABLE_WORK=y
CONFIG_POUCH_TRANSPORT_NONE=y
CONFIG_ESP_SYSTEM_PANIC_PRINT_HALT=y
CONFIG_LOG_MAXIMUM_LEVEL_DEBUG=y
```

## tests/pouch/downlink/testcase.yaml
```yaml
common:
  platform_allow:
    - native_sim
    - native_sim/native/64
  integration_platforms:
    - native_sim
    - native_sim/native/64
  tags: test_framework
tests:
  pouch.downlink.id123:
    extra_configs:
      - CONFIG_POUCH_DEVICE_NAME="id123"
  pouch.downlink.very-long-device-name-with-id123:
    extra_configs:
      - CONFIG_POUCH_DEVICE_NAME="very-long-device-name-with-id123"
  pouch.downlink.id123.mtu.250:
    extra_configs:
      - CONFIG_POUCH_TRANSPORT_MTU=250
```

## tests/pouch/gatt_broker/testcase.yaml
```yaml
tests:
  pouch.gatt_broker:
    platform_allow:
      - native_sim
      - native_sim/native/64
    integration_platforms:
      - native_sim
    tags: test_framework
```

## tests/pouch/uplink/testcase.yaml
```yaml
tests:
  pouch.uplink:
    platform_allow:
      - native_sim
    integration_platforms:
      - native_sim
    tags: test_framework
```

## west.yml
```yaml
# Copyright (c) 2025 Golioth, Inc.
# SPDX-License-Identifier: Apache-2.0

manifest:
  version: 0.8

  projects:
    - name: zephyr
      revision: v4.2.0
      url: https://github.com/zephyrproject-rtos/zephyr
      west-commands: scripts/west-commands.yml
      import:
        name-allowlist:
          - zephyr
          - cmsis_6
          - hal_nordic
          - hal_espressif
          - mbedtls
          - mcuboot
          - segger
          - tfm-mcuboot
          - trusted-firmware-m
          - littlefs
          - zcbor

  self:
    path: pouch
```
