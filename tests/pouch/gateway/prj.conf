## CMakeLists.txt
```
# SPDX-License-Identifier: Apache-2.0

cmake_minimum_required(VERSION 3.20.0)

find_package(Zephyr REQUIRED HINTS $ENV{ZEPHYR_BASE})
project(gateway_test)

# The gateway library's full Zephyr build pulls in the BT broker
# transport which requires a Bluetooth stack.  For unit tests we
# compile only the gateway core sources we want to exercise, alongside
# the test sources.
target_sources(app PRIVATE
  src/cloud.c
  src/downlink.c
  src/uplink.c
  src/stub_blockbuf.c
  src/wrap.c
  ${ZEPHYR_POUCH_MODULE_DIR}/src/gateway/cloud.c
  ${ZEPHYR_POUCH_MODULE_DIR}/src/gateway/downlink.c
  ${ZEPHYR_POUCH_MODULE_DIR}/src/gateway/uplink.c
  ${ZEPHYR_POUCH_MODULE_DIR}/src/block.c
  ${ZEPHYR_POUCH_MODULE_DIR}/src/buf.c
)

target_link_options(app PUBLIC -Wl,--wrap=free -Wl,--wrap=pouch_msgq_get
                    -Wl,--wrap=pouch_atomic_get_value)

target_include_directories(app PRIVATE
  ${ZEPHYR_POUCH_MODULE_DIR}/include
  ${ZEPHYR_POUCH_MODULE_DIR}/port/include
  ${ZEPHYR_POUCH_MODULE_DIR}/src
  ${ZEPHYR_POUCH_MODULE_DIR}/src/gateway
)

# Provide the macros that the bypassed POUCH_GATEWAY Kconfig tree would
# normally generate.
target_compile_definitions(app PRIVATE
  CONFIG_POUCH_GATEWAY_LOG_LEVEL=3
  CONFIG_POUCH_GATEWAY_NUM_BLOCKS=4
  CONFIG_POUCH_GATEWAY_DOWNLINK_BLOCK_TIMEOUT=1
  CONFIG_POUCH_GATEWAY_CLOUD=1
  CONFIG_POUCH_GATEWAY_WORKQ_STACK_SIZE=2048
  CONFIG_POUCH_GATEWAY_WORKQ_PRIORITY=5
  CONFIG_POUCH_BLOCK_SIZE=1024
)
```

## prj.conf
```kconfig
CONFIG_ZTEST=y

# We compile selected src/gateway sources into the test app directly
# (see CMakeLists.txt) so we don't have to enable the full POUCH_GATEWAY
# Kconfig and pull in BT / SAR / broker endpoint dependencies.  Settings
# expected by those sources (log level, block size knobs) are provided
# as -D macros from CMakeLists.txt.
CONFIG_LOG=y
```

## src/cloud.c
```c
/*
 * Copyright (c) 2026 Golioth, Inc.
 *
 * SPDX-License-Identifier: Apache-2.0
 *
 * Unit tests for the gateway cloud transport dispatcher
 * (src/gateway/cloud.c).
 */

#include <errno.h>
#include <string.h>

#include <zephyr/ztest.h>

#include <pouch/gateway/cloud.h>

/*--------------------------------------------------
 * Stub cloud transport that records every call.
 *------------------------------------------------*/

struct stub_state
{
    int ensure_calls;
    int forward_calls;
    int cert_calls;

    int ensure_rc;
    int forward_rc;
    int cert_rc;

    /* Last forward_pouch arguments. */
    uint8_t last_payload[256];
    size_t last_payload_len;
    pouch_gateway_cloud_upload_chunk_cb_t last_chunk_cb;
    void *last_chunk_arg;
    pouch_gateway_cloud_block2_cb_t last_resp_cb;
    void *last_resp_arg;

    /* Last upload_device_cert arguments. */
    uint8_t last_cert[256];
    size_t last_cert_len;
};

static struct stub_state stub;

static int stub_ensure(void)
{
    stub.ensure_calls++;
    return stub.ensure_rc;
}

static int stub_forward(pouch_gateway_cloud_upload_chunk_cb_t chunk_cb,
                        void *chunk_arg,
                        pouch_gateway_cloud_block2_cb_t resp_cb,
                        void *resp_arg)
{
    stub.forward_calls++;
    stub.last_chunk_cb = chunk_cb;
    stub.last_chunk_arg = chunk_arg;
    stub.last_resp_cb = resp_cb;
    stub.last_resp_arg = resp_arg;

    /* Drain the streaming source into a linear buffer so tests can
     * inspect the aggregated payload.
     */
    stub.last_payload_len = 0;

    if (chunk_cb != NULL)
    {
        while (stub.last_payload_len < sizeof(stub.last_payload))
        {
            size_t chunk_len = 0;
            bool is_last = false;
            int err = chunk_cb(stub.last_payload + stub.last_payload_len,
                               sizeof(stub.last_payload) - stub.last_payload_len,
                               &chunk_len,
                               &is_last,
                               chunk_arg);
            if (err)
            {
                return err;
            }
            stub.last_payload_len += chunk_len;
            if (is_last)
            {
                break;
            }
        }
    }

    return stub.forward_rc;
}

static int stub_upload_cert(const uint8_t *cert, size_t len)
{
    stub.cert_calls++;
    if (len <= sizeof(stub.last_cert))
    {
        memcpy(stub.last_cert, cert, len);
    }
    stub.last_cert_len = len;
    return stub.cert_rc;
}

static const struct pouch_gateway_cloud_transport stub_transport = {
    .ensure_ready = stub_ensure,
    .forward_pouch = stub_forward,
    .upload_device_cert = stub_upload_cert,
};

/*--------------------------------------------------
 * Tests
 *------------------------------------------------*/

static void cloud_setup(void *fixture)
{
    ARG_UNUSED(fixture);
    memset(&stub, 0, sizeof(stub));
    pouch_gateway_cloud_transport_register(NULL);
}

ZTEST_SUITE(cloud, NULL, NULL, cloud_setup, NULL, NULL);

static int noop_chunk_cb(uint8_t *buf, size_t buf_size, size_t *chunk_len, bool *is_last, void *arg)
{
    ARG_UNUSED(buf);
    ARG_UNUSED(buf_size);
    ARG_UNUSED(arg);
    *chunk_len = 0;
    *is_last = true;
    return 0;
}

ZTEST(cloud, test_dispatch_with_no_transport_returns_enodev)
{
    zassert_equal(pouch_gateway_cloud_ensure_ready(),
                  0,
                  "ensure_ready is optional and must succeed when not registered");

    zassert_equal(pouch_gateway_cloud_forward_pouch(noop_chunk_cb, NULL, NULL, NULL), -ENODEV);

    zassert_equal(pouch_gateway_cloud_upload_device_cert((const uint8_t *) "x", 1), -ENODEV);
}

ZTEST(cloud, test_register_and_get)
{
    zassert_is_null(pouch_gateway_cloud_transport_get());

    pouch_gateway_cloud_transport_register(&stub_transport);
    zassert_equal_ptr(pouch_gateway_cloud_transport_get(), &stub_transport);

    pouch_gateway_cloud_transport_register(NULL);
    zassert_is_null(pouch_gateway_cloud_transport_get());
}

struct fixed_source
{
    const uint8_t *data;
    size_t len;
    size_t offset;
};

static int fixed_chunk_cb(uint8_t *buf,
                          size_t buf_size,
                          size_t *chunk_len,
                          bool *is_last,
                          void *arg)
{
    struct fixed_source *src = arg;
    size_t take = MIN(buf_size, src->len - src->offset);

    memcpy(buf, src->data + src->offset, take);
    src->offset += take;
    *chunk_len = take;
    *is_last = (src->offset == src->len);
    return 0;
}

ZTEST(cloud, test_dispatch_invokes_stub)
{
    pouch_gateway_cloud_transport_register(&stub_transport);

    /* ensure_ready */
    stub.ensure_rc = 0;
    zassert_equal(pouch_gateway_cloud_ensure_ready(), 0);
    zassert_equal(stub.ensure_calls, 1);

    /* forward_pouch */
    const uint8_t payload[] = {'a', 'b', 'c'};
    struct fixed_source src = {.data = payload, .len = sizeof(payload)};
    int marker = 42;
    pouch_gateway_cloud_block2_cb_t cb_marker =
        (pouch_gateway_cloud_block2_cb_t) (uintptr_t) 0xfeed;

    stub.forward_rc = 7;
    zassert_equal(pouch_gateway_cloud_forward_pouch(fixed_chunk_cb, &src, cb_marker, &marker), 7);
    zassert_equal(stub.forward_calls, 1);
    zassert_equal(stub.last_payload_len, sizeof(payload));
    zassert_mem_equal(stub.last_payload, payload, sizeof(payload));
    zassert_equal_ptr(stub.last_resp_cb, cb_marker);
    zassert_equal_ptr(stub.last_resp_arg, &marker);

    /* upload_device_cert */
    const uint8_t cert[] = {0xde, 0xad, 0xbe, 0xef};
    stub.cert_rc = -EAGAIN;
    zassert_equal(pouch_gateway_cloud_upload_device_cert(cert, sizeof(cert)), -EAGAIN);
    zassert_equal(stub.cert_calls, 1);
    zassert_equal(stub.last_cert_len, sizeof(cert));
    zassert_mem_equal(stub.last_cert, cert, sizeof(cert));
}

/* Second stub used by the replacement test. */
static int alt_forward_calls;
static int alt_forward_rc;

static int alt_forward(pouch_gateway_cloud_upload_chunk_cb_t chunk_cb,
                       void *chunk_arg,
                       pouch_gateway_cloud_block2_cb_t resp_cb,
                       void *resp_arg)
{
    ARG_UNUSED(chunk_cb);
    ARG_UNUSED(chunk_arg);
    ARG_UNUSED(resp_cb);
    ARG_UNUSED(resp_arg);
    alt_forward_calls++;
    return alt_forward_rc;
}

static const struct pouch_gateway_cloud_transport alt_transport = {
    .forward_pouch = alt_forward,
};

ZTEST(cloud, test_register_replaces_previous)
{
    alt_forward_calls = 0;
    alt_forward_rc = 13;

    pouch_gateway_cloud_transport_register(&stub_transport);
    pouch_gateway_cloud_transport_register(&alt_transport);

    zassert_equal(pouch_gateway_cloud_forward_pouch(noop_chunk_cb, NULL, NULL, NULL), 13);
    zassert_equal(alt_forward_calls, 1, "Replacement transport should be active");
    zassert_equal(stub.forward_calls, 0, "Original transport should not be called");
}
```

## src/downlink.c
```c
/*
 * Copyright (c) 2026 Golioth, Inc.
 *
 * SPDX-License-Identifier: Apache-2.0
 *
 * Tests for the gateway downlink module (src/gateway/downlink.c).
 *
 * The downlink module receives data chunks from the cloud (via
 * pouch_gateway_downlink_block_cb) and lets a consumer drain them
 * via pouch_gateway_downlink_get_data.  It also signals completion
 * via the data_available callback.
 */

#include <errno.h>
#include <stdbool.h>
#include <string.h>

#include <zephyr/kernel.h>
#include <zephyr/ztest.h>

#include "block.h"
#include "gateway/downlink.h"

#include "stub_blockbuf.h"

/* Number of times the data_available callback has fired. */
static int data_available_calls;

static void data_available_cb(void *arg)
{
    ARG_UNUSED(arg);
    data_available_calls++;
}

static void downlink_setup(void *fixture)
{
    ARG_UNUSED(fixture);
    data_available_calls = 0;
    stub_blockbuf_reset_counters();
}

ZTEST_SUITE(downlink, NULL, NULL, downlink_setup, NULL, NULL);

ZTEST(downlink, test_open_close)
{
    struct pouch_gateway_downlink_context *dl =
        pouch_gateway_downlink_open(data_available_cb, NULL);
    zassert_not_null(dl);
    zassert_false(pouch_gateway_downlink_is_complete(dl));

    pouch_gateway_downlink_close(dl);
}

ZTEST(downlink, test_get_data_empty_returns_no_bytes_and_arms_callback)
{
    struct pouch_gateway_downlink_context *dl =
        pouch_gateway_downlink_open(data_available_cb, NULL);
    zassert_not_null(dl);
    pouch_gateway_downlink_acquire(dl);

    uint8_t buf[32];
    size_t dst_len = sizeof(buf);
    bool is_last = true;

    int err = pouch_gateway_downlink_get_data(dl, buf, &dst_len, &is_last);
    zassert_ok(err);
    zassert_equal(dst_len, 0);
    zassert_false(is_last);

    /* Pushing a block now should fire the data_available callback. */
    const uint8_t chunk[] = {'h', 'i'};
    err = pouch_gateway_downlink_block_cb(chunk, sizeof(chunk), false, dl);
    zassert_ok(err);
    zassert_equal(data_available_calls, 1);

    pouch_gateway_downlink_end_cb(0, dl);
    pouch_gateway_downlink_close(dl);
}

ZTEST(downlink, test_single_block_round_trip)
{
    struct pouch_gateway_downlink_context *dl =
        pouch_gateway_downlink_open(data_available_cb, NULL);
    pouch_gateway_downlink_acquire(dl);

    const uint8_t chunk[] = {'p', 'o', 'u', 'c', 'h'};
    int err = pouch_gateway_downlink_block_cb(chunk, sizeof(chunk), true, dl);
    zassert_ok(err);

    /* Drain in one shot. */
    uint8_t buf[8] = {0};
    size_t dst_len = sizeof(buf);
    bool is_last = false;
    err = pouch_gateway_downlink_get_data(dl, buf, &dst_len, &is_last);
    zassert_ok(err);
    zassert_equal(dst_len, sizeof(chunk));
    zassert_mem_equal(buf, chunk, sizeof(chunk));
    zassert_true(is_last);
    zassert_true(pouch_gateway_downlink_is_complete(dl));

    pouch_gateway_downlink_end_cb(0, dl);
    pouch_gateway_downlink_close(dl);
}

ZTEST(downlink, test_multi_block_concatenation_and_is_last)
{
    struct pouch_gateway_downlink_context *dl =
        pouch_gateway_downlink_open(data_available_cb, NULL);
    pouch_gateway_downlink_acquire(dl);

    const uint8_t a[] = {'a', 'b', 'c'};
    const uint8_t b[] = {'d', 'e', 'f', 'g'};
    const uint8_t c[] = {'h', 'i'};

    zassert_ok(pouch_gateway_downlink_block_cb(a, sizeof(a), false, dl));
    zassert_ok(pouch_gateway_downlink_block_cb(b, sizeof(b), false, dl));
    zassert_ok(pouch_gateway_downlink_block_cb(c, sizeof(c), true, dl));

    /* Drain a few bytes at a time to exercise the cross-block path. */
    uint8_t buf[16] = {0};
    size_t total = 0;
    bool is_last = false;

    while (!is_last)
    {
        size_t want = 4; /* less than any single block */
        int err = pouch_gateway_downlink_get_data(dl, buf + total, &want, &is_last);
        zassert_ok(err);
        zassert_true(want > 0 || is_last);
        total += want;
        if (total >= sizeof(buf))
        {
            break;
        }
    }

    zassert_equal(total, sizeof(a) + sizeof(b) + sizeof(c));
    zassert_mem_equal(buf, "abcdefghi", 9);
    zassert_true(pouch_gateway_downlink_is_complete(dl));

    pouch_gateway_downlink_end_cb(0, dl);
    pouch_gateway_downlink_close(dl);
}

ZTEST(downlink, test_block_cb_rejected_after_abort)
{
    struct pouch_gateway_downlink_context *dl =
        pouch_gateway_downlink_open(data_available_cb, NULL);
    pouch_gateway_downlink_acquire(dl);

    /* Push one block, then abort.  Abort marks the downlink as
     * aborted; subsequent block_cb calls must be rejected.
     */
    zassert_ok(pouch_gateway_downlink_block_cb((const uint8_t *) "x", 1, false, dl));

    pouch_gateway_downlink_abort(dl);

    int err = pouch_gateway_downlink_block_cb((const uint8_t *) "y", 1, false, dl);
    zassert_equal(err, -ECANCELED);

    pouch_gateway_downlink_end_cb(-ECANCELED, dl);
}

/* The callback argument points at the context the notification aborts. */
static void abort_from_notification_cb(void *arg)
{
    struct pouch_gateway_downlink_context **dl = arg;

    data_available_calls++;
    pouch_gateway_downlink_abort(*dl);
}

ZTEST(downlink, test_abort_from_notification_stops_a_split_payload_mid_callback)
{
    /* Two full chunks, so the loop has one left when the notification for
     * the first one aborts the downlink.
     */
    static const uint8_t payload[2 * MAX_PLAINTEXT_BLOCK_SIZE];
    struct pouch_gateway_downlink_context *dl;

    dl = pouch_gateway_downlink_open(abort_from_notification_cb, &dl);
    zassert_not_null(dl);
    pouch_gateway_downlink_acquire(dl);

    int err = pouch_gateway_downlink_block_cb(payload, sizeof(payload), true, dl);
    zassert_equal(data_available_calls, 1, "the abort has to land inside the loop");
    zassert_equal(stub_blockbuf_alloc_count(), 1, "a chunk was allocated after the abort");
    zassert_equal(err, -ECANCELED);

    /* As the cloud transport does after a failed block_cb(). */
    pouch_gateway_downlink_end_cb(-ECANCELED, dl);
    zassert_equal(stub_blockbuf_in_use(), 0);
}

ZTEST(downlink, test_end_cb_failure_makes_drain_complete_with_is_last)
{
    struct pouch_gateway_downlink_context *dl =
        pouch_gateway_downlink_open(data_available_cb, NULL);
    pouch_gateway_downlink_acquire(dl);

    /* Simulate a cloud-side error before any block was queued. */
    pouch_gateway_downlink_end_cb(-EIO, dl);

    /* Should now have fired data_available so the consumer can drain. */
    zassert_equal(data_available_calls, 1);

    uint8_t buf[8];
    size_t dst_len = sizeof(buf);
    bool is_last = false;
    int err = pouch_gateway_downlink_get_data(dl, buf, &dst_len, &is_last);
    zassert_ok(err);
    zassert_equal(dst_len, 0);
    zassert_true(is_last);
    zassert_true(pouch_gateway_downlink_is_complete(dl));

    pouch_gateway_downlink_close(dl);
}
```

## src/leak_check.h
```c
/*
 * Copyright (c) 2026 Golioth, Inc.
 *
 * SPDX-License-Identifier: Apache-2.0
 */

#pragma once

#include <zephyr/ztest.h>

#include "stub_blockbuf.h"
#include "wrap.h"

/** Assert that the watched pointer was freed once and that no blockbuf block is in use. */
static inline void assert_all_released(void)
{
    zassert_equal(wrap_free_count(), 1, "context not freed exactly once");
    zassert_equal(stub_blockbuf_in_use(), 0, "blocks leaked");
}
```

## src/stub_blockbuf.c
```c
/*
 * Copyright (c) 2026 Golioth, Inc.
 *
 * SPDX-License-Identifier: Apache-2.0
 *
 * Minimal blockbuf stub for unit tests.  The real Zephyr blockbuf
 * (port/zephyr/blockbuf.c) defines a static k_mem_slab dimensioned
 * by CONFIG_POUCH_BLOCK_SIZE / CONFIG_POUCH_BLOCK_COUNT which pull
 * in more of the pouch core than these tests need.  This stub uses
 * malloc and avoids the Kconfig dependency.
 */

#include <pouch/blockbuf.h>

#include "../../../src/buf.h"

#include "stub_blockbuf.h"

#define STUB_BLOCKBUF_SIZE 4096

static size_t alloc_count;
static size_t free_count;

size_t stub_blockbuf_alloc_count(void)
{
    return alloc_count;
}

size_t stub_blockbuf_in_use(void)
{
    return alloc_count - free_count;
}

void stub_blockbuf_reset_counters(void)
{
    alloc_count = 0;
    free_count = 0;
}

struct pouch_buf *blockbuf_alloc(pouch_timeout_t timeout)
{
    (void) timeout;

    struct pouch_buf *buf = buf_alloc(STUB_BLOCKBUF_SIZE);
    if (buf != NULL)
    {
        alloc_count++;
    }

    return buf;
}

void blockbuf_free(struct pouch_buf *buf)
{
    free_count++;
    buf_free(buf);
}
```

## src/stub_blockbuf.h
```c
/*
 * Copyright (c) 2026 Golioth, Inc.
 *
 * SPDX-License-Identifier: Apache-2.0
 */

#pragma once

#include <stddef.h>

/** Number of blockbuf_alloc() calls that returned a buffer. */
size_t stub_blockbuf_alloc_count(void);

/** Buffers returned by blockbuf_alloc() and not yet freed. */
size_t stub_blockbuf_in_use(void);

/** Zero the alloc and free counters and stop failing allocations. */
void stub_blockbuf_reset_counters(void);

/**
 * Make blockbuf_alloc() return NULL from its @p nth call on (1-based, counted since the last
 * reset). 0 disables.
 */
void stub_blockbuf_fail_alloc_from(size_t nth);
```

## src/uplink.c
```c
/*
 * Copyright (c) 2026 Golioth, Inc.
 *
 * SPDX-License-Identifier: Apache-2.0
 *
 * Tests for the gateway uplink module (src/gateway/uplink.c).
 *
 * The uplink module buffers data written by the broker side and
 * forwards the concatenated payload to the cloud transport (via
 * pouch_gateway_cloud_forward_pouch) when close() is called.  It
 * notifies the caller via an end_cb describing whether the forward
 * succeeded.
 */

#include <errno.h>
#include <stdbool.h>
#include <string.h>

#include <zephyr/kernel.h>
#include <zephyr/ztest.h>

#include <pouch/gateway/cloud.h>
#include "gateway/downlink.h"
#include <pouch/gateway/uplink.h>

/*--------------------------------------------------
 * Stub cloud transport
 *------------------------------------------------*/

#define MAX_FORWARDED 4096
#define STUB_CHUNK_SIZE 128

static struct
{
    int forward_calls;
    int forward_rc;
    uint8_t payload[MAX_FORWARDED];
    size_t payload_len;
    pouch_gateway_cloud_block2_cb_t resp_cb;
    void *resp_arg;
    /* Delivered as a single final Block2 response block when not NULL. */
    const uint8_t *response;
    size_t response_len;
} stub;

static int stub_forward(pouch_gateway_cloud_upload_chunk_cb_t chunk_cb,
                        void *chunk_arg,
                        pouch_gateway_cloud_block2_cb_t resp_cb,
                        void *resp_arg)
{
    stub.forward_calls++;
    stub.resp_cb = resp_cb;
    stub.resp_arg = resp_arg;
    stub.payload_len = 0;

    /* Drain the chunk source into a linear buffer so the tests can
     * inspect what the uplink actually produced. Cap each pull at
     * STUB_CHUNK_SIZE to exercise multi-chunk streaming.
     */
    if (chunk_cb != NULL)
    {
        while (stub.payload_len < sizeof(stub.payload))
        {
            size_t space = MIN(STUB_CHUNK_SIZE, sizeof(stub.payload) - stub.payload_len);
            size_t chunk_len = 0;
            bool is_last = false;

            int err =
                chunk_cb(stub.payload + stub.payload_len, space, &chunk_len, &is_last, chunk_arg);
            if (err)
            {
                return err;
            }
            stub.payload_len += chunk_len;
            if (is_last)
            {
                break;
            }
        }
    }

    if (stub.response != NULL)
    {
        int err = resp_cb(stub.response, stub.response_len, true, resp_arg);
        if (err)
        {
            return err;
        }
    }

    return stub.forward_rc;
}

static const struct pouch_gateway_cloud_transport stub_transport = {
    .forward_pouch = stub_forward,
};

/*--------------------------------------------------
 * End-cb capture
 *------------------------------------------------*/

static int end_cb_calls;
static enum pouch_gateway_uplink_result end_cb_result;

static void on_end(void *arg, enum pouch_gateway_uplink_result res)
{
    ARG_UNUSED(arg);
    end_cb_calls++;
    end_cb_result = res;
}

/*--------------------------------------------------
 * Suite
 *------------------------------------------------*/

static void uplink_setup(void *fixture)
{
    ARG_UNUSED(fixture);
    memset(&stub, 0, sizeof(stub));
    end_cb_calls = 0;
    end_cb_result = -1;
    pouch_gateway_cloud_transport_register(&stub_transport);
}

static void uplink_teardown(void *fixture)
{
    ARG_UNUSED(fixture);
    pouch_gateway_cloud_transport_register(NULL);
}

ZTEST_SUITE(uplink, NULL, NULL, uplink_setup, uplink_teardown, NULL);

ZTEST(uplink, test_open_close_with_no_data)
{
    struct pouch_gateway_uplink *up = pouch_gateway_uplink_open(NULL, on_end, NULL);
    zassert_not_null(up);

    pouch_gateway_uplink_close(up);

    zassert_equal(end_cb_calls, 1);
    zassert_equal(end_cb_result, POUCH_GATEWAY_UPLINK_SUCCESS);
    zassert_equal(stub.forward_calls, 0, "Empty uplink should not call forward");
}

ZTEST(uplink, test_write_then_close_forwards_payload)
{
    struct pouch_gateway_uplink *up = pouch_gateway_uplink_open(NULL, on_end, NULL);
    zassert_not_null(up);

    const uint8_t chunk[] = {'h', 'e', 'l', 'l', 'o'};
    zassert_ok(pouch_gateway_uplink_write(up, chunk, sizeof(chunk)));

    pouch_gateway_uplink_close(up);

    zassert_equal(end_cb_calls, 1);
    zassert_equal(end_cb_result, POUCH_GATEWAY_UPLINK_SUCCESS);
    zassert_equal(stub.forward_calls, 1);
    zassert_equal(stub.payload_len, sizeof(chunk));
    zassert_mem_equal(stub.payload, chunk, sizeof(chunk));
}

ZTEST(uplink, test_multiple_writes_concatenate)
{
    struct pouch_gateway_uplink *up = pouch_gateway_uplink_open(NULL, on_end, NULL);
    zassert_not_null(up);

    const uint8_t a[] = "abc";
    const uint8_t b[] = "def";
    const uint8_t c[] = "ghij";
    zassert_ok(pouch_gateway_uplink_write(up, a, 3));
    zassert_ok(pouch_gateway_uplink_write(up, b, 3));
    zassert_ok(pouch_gateway_uplink_write(up, c, 4));

    pouch_gateway_uplink_close(up);

    zassert_equal(stub.forward_calls, 1);
    zassert_equal(stub.payload_len, 10);
    zassert_mem_equal(stub.payload, "abcdefghij", 10);
    zassert_equal(end_cb_result, POUCH_GATEWAY_UPLINK_SUCCESS);
}

ZTEST(uplink, test_forward_error_propagates_to_end_cb)
{
    stub.forward_rc = -EIO;

    struct pouch_gateway_uplink *up = pouch_gateway_uplink_open(NULL, on_end, NULL);
    zassert_not_null(up);
    zassert_ok(pouch_gateway_uplink_write(up, (const uint8_t *) "x", 1));
    pouch_gateway_uplink_close(up);

    zassert_equal(stub.forward_calls, 1);
    zassert_equal(end_cb_calls, 1);
    zassert_equal(end_cb_result, POUCH_GATEWAY_UPLINK_ERROR_CLOUD);
}

static int dl_armed_calls;
static void dl_armed_cb(void *arg)
{
    ARG_UNUSED(arg);
    dl_armed_calls++;
}

ZTEST(uplink, test_forwards_to_downlink_via_resp_cb)
{
    dl_armed_calls = 0;

    struct pouch_gateway_downlink_context *dl = pouch_gateway_downlink_open(dl_armed_cb, NULL);
    zassert_not_null(dl);

    stub.response = (const uint8_t *) "RESP";
    stub.response_len = 4;

    struct pouch_gateway_uplink *up = pouch_gateway_uplink_open(dl, on_end, NULL);
    zassert_not_null(up);
    zassert_ok(pouch_gateway_uplink_write(up, (const uint8_t *) "p", 1));
    pouch_gateway_uplink_close(up);

    /* The uplink should hand the stub a non-NULL resp_cb tied to the
     * downlink context.
     */
    zassert_equal(stub.forward_calls, 1);
    zassert_not_null(stub.resp_cb);
    zassert_equal_ptr(stub.resp_arg, dl);

    /* Drain the downlink and verify "RESP". */
    uint8_t out[8] = {0};
    size_t out_len = sizeof(out);
    bool is_last = false;
    zassert_ok(pouch_gateway_downlink_get_data(dl, out, &out_len, &is_last));
    zassert_equal(out_len, 4);
    zassert_mem_equal(out, "RESP", 4);
    zassert_true(is_last);

    pouch_gateway_downlink_close(dl);
}

ZTEST(uplink, test_streaming_across_many_writes)
{
    /* Push enough bytes to span several block-pool blocks and
     * multiple stub streaming chunks so we exercise both the
     * queue-drain path and the last-chunk short-copy path.
     */
    struct pouch_gateway_uplink *up = pouch_gateway_uplink_open(NULL, on_end, NULL);
    zassert_not_null(up);

    const size_t chunks = 20;
    const size_t chunk_len = 200;
    uint8_t chunk[chunk_len];

    for (size_t i = 0; i < chunks; i++)
    {
        memset(chunk, (int) ('A' + (i % 26)), sizeof(chunk));
        zassert_ok(pouch_gateway_uplink_write(up, chunk, sizeof(chunk)));
    }

    pouch_gateway_uplink_close(up);

    zassert_equal(stub.forward_calls, 1);
    zassert_equal(stub.payload_len, chunks * chunk_len);

    for (size_t i = 0; i < chunks; i++)
    {
        for (size_t j = 0; j < chunk_len; j++)
        {
            zassert_equal(stub.payload[i * chunk_len + j], (uint8_t) ('A' + (i % 26)));
        }
    }
}

ZTEST(uplink, test_cloud_disabled_at_kconfig_skips_forward_locally)
{
    /* This test pretends the gateway has CONFIG_POUCH_GATEWAY_CLOUD=n
     * by unregistering the transport before closing.  In that case
     * the uplink should still end successfully but with no forward.
     */
    pouch_gateway_cloud_transport_register(NULL);

    struct pouch_gateway_uplink *up = pouch_gateway_uplink_open(NULL, on_end, NULL);
    zassert_not_null(up);
    zassert_ok(pouch_gateway_uplink_write(up, (const uint8_t *) "z", 1));
    pouch_gateway_uplink_close(up);

    /* No transport -> cloud_forward returns -ENODEV -> uplink reports
     * an ERROR_CLOUD.  This codifies current behaviour; if we later
     * change it to silently succeed, update this test.
     */
    zassert_equal(end_cb_calls, 1);
    zassert_equal(end_cb_result, POUCH_GATEWAY_UPLINK_ERROR_CLOUD);
}
```

## src/wrap.c
```c
/*
 * Copyright (c) 2026 Golioth, Inc.
 *
 * SPDX-License-Identifier: Apache-2.0
 */

#include <stddef.h>

#include <pouch/port.h>

#include "wrap.h"

static const void *watched;
static unsigned int watched_frees;

static void (*empty_get_hook)(void *);
static void *empty_get_arg;
static unsigned int empty_gets_left;

static void (*get_value_hook)(void *);
static void *get_value_arg;

void __real_free(void *ptr);
int __real_pouch_msgq_get(pouch_msgq_t *msgq, void *buf, pouch_timeout_t timeout);
long __real_pouch_atomic_get_value(const pouch_atomic_t *target);

void __wrap_free(void *ptr)
{
    if (ptr != NULL && ptr == watched)
    {
        watched_frees++;
    }

    __real_free(ptr);
}

int __wrap_pouch_msgq_get(pouch_msgq_t *msgq, void *buf, pouch_timeout_t timeout)
{
    int err = __real_pouch_msgq_get(msgq, buf, timeout);

    if (err != 0 && empty_get_hook != NULL && --empty_gets_left == 0)
    {
        void (*hook)(void *) = empty_get_hook;

        empty_get_hook = NULL;
        hook(empty_get_arg);
    }

    return err;
}

long __wrap_pouch_atomic_get_value(const pouch_atomic_t *target)
{
    long value = __real_pouch_atomic_get_value(target);

    if (get_value_hook != NULL)
    {
        void (*hook)(void *) = get_value_hook;

        get_value_hook = NULL;
        hook(get_value_arg);
    }

    return value;
}

void wrap_free_watch(const void *ptr)
{
    watched = ptr;
    watched_frees = 0;
}

unsigned int wrap_free_count(void)
{
    return watched_frees;
}

void wrap_msgq_get_empty_hook(unsigned int nth, void (*hook)(void *), void *arg)
{
    empty_get_hook = hook;
    empty_get_arg = arg;
    empty_gets_left = nth;
}

void wrap_atomic_get_value_hook(void (*hook)(void *), void *arg)
{
    get_value_hook = hook;
    get_value_arg = arg;
}

void wrap_hooks_disarm(void)
{
    empty_get_hook = NULL;
    get_value_hook = NULL;
}

bool wrap_hook_pending(void)
{
    return empty_get_hook != NULL || get_value_hook != NULL;
}
```

## src/wrap.h
```c
/*
 * Copyright (c) 2026 Golioth, Inc.
 *
 * SPDX-License-Identifier: Apache-2.0
 */

#pragma once

#include <stdbool.h>

/** Count free() calls on @p ptr from now on, starting from zero. */
void wrap_free_watch(const void *ptr);

/** Number of free() calls on the pointer passed to wrap_free_watch(). */
unsigned int wrap_free_count(void);

/**
 * Run @p hook with @p arg once, after the @p nth (from 1) pouch_msgq_get() from now on that
 * finds its queue empty.
 *
 * Assumes the drain's 1st empty read comes before it arms WAITING, its 2nd after the snapshot.
 */
void wrap_msgq_get_empty_hook(unsigned int nth, void (*hook)(void *), void *arg);

/**
 * Run @p hook with @p arg once, after the next pouch_atomic_get_value().
 *
 * Assumes the drain's flags snapshot is its only pouch_atomic_get_value() call.
 */
void wrap_atomic_get_value_hook(void (*hook)(void *), void *arg);

/** Disarm both hooks. */
void wrap_hooks_disarm(void);

/** True while a hook is armed and has not run. */
bool wrap_hook_pending(void);
```
