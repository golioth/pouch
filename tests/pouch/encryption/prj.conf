## CMakeLists.txt
```
# PDX-License-Identifier: Apache-2.0

cmake_minimum_required(VERSION 3.20.0)

find_package(Zephyr REQUIRED HINTS $ENV{ZEPHYR_BASE})
project(encryption_test)

target_sources(app PRIVATE src/main.c)
```

## prj.conf
```kconfig
CONFIG_POUCH=y
CONFIG_BT=y
CONFIG_BT_PERIPHERAL=y
CONFIG_POUCH_TRANSPORT_BLE_GATT=y
```

## src/main.c
```c
/*
 * Copyright (c) 2025 Golioth, Inc.
 */
#include <pouch/pouch.h>
#include <psa/crypto.h>


int main(void)
{
    struct pouch_config config = {
        .private_key = PSA_KEY_ID_NULL,
    };
    return pouch_init(&config);
}
```
