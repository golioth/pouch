## CMakeLists.txt
```
# PDX-License-Identifier: Apache-2.0

cmake_minimum_required(VERSION 3.20.0)

find_package(Zephyr REQUIRED HINTS $ENV{ZEPHYR_BASE})
project(port_zephyr_test)

target_sources(app PRIVATE
  src/test_atomic.c
  src/test_semaphore.c
  src/test_delayable_work.c
)

add_subdirectory(../common common)
```

## prj.conf
```kconfig
CONFIG_ZTEST=y
CONFIG_POUCH=y
CONFIG_POUCH_ENCRYPTION_MOCK=y
```

## src/test_atomic.c
```c
#include <zephyr/ztest.h>
#include <limits.h>
#include <pouch/port.h>

ZTEST(atomic, test_atomic_inc_dec)
{
    pouch_atomic_t val = POUCH_ATOMIC_INIT(0);
    zassert_equal(pouch_atomic_get_value(&val), 0, "Initial value not zero");

    zassert_equal(pouch_atomic_inc(&val), 0, "Inc should return old value");
    zassert_equal(pouch_atomic_get_value(&val), 1, "Value should be 1 after inc");

    zassert_equal(pouch_atomic_dec(&val), 1, "Dec should return old value");
    zassert_equal(pouch_atomic_get_value(&val), 0, "Value should be 0 after dec");
}

ZTEST(atomic, test_atomic_set_clear)
{
    pouch_atomic_t val = POUCH_ATOMIC_INIT(0);
    zassert_equal(pouch_atomic_set(&val, 42), 0, "Set should return old value");
    zassert_equal(pouch_atomic_get_value(&val), 42, "Value should be 42 after set");

    zassert_equal(pouch_atomic_clear(&val), 42, "Clear should return old value");
    zassert_equal(pouch_atomic_get_value(&val), 0, "Value should be 0 after clear");
}

ZTEST(atomic, test_atomic_overflow_underflow)
{
    pouch_atomic_t val = POUCH_ATOMIC_INIT(0);
    zassert_equal(pouch_atomic_dec(&val), 0, "Dec should return old value");
    zassert_equal(pouch_atomic_get_value(&val), -1, "Value should be -1 after underflow");

    zassert_equal(pouch_atomic_set(&val, LONG_MAX), -1, "Set should return old value");
    zassert_equal(pouch_atomic_inc(&val), LONG_MAX, "Inc should return old value");
    zassert_equal(pouch_atomic_get_value(&val),
                  LONG_MIN,
                  "Value should be LONG_MIN after overflow");
    zassert_equal(pouch_atomic_dec(&val), LONG_MIN, "Dec should return old value");
    zassert_equal(pouch_atomic_get_value(&val),
                  LONG_MAX,
                  "Value should be LONG_MIN after underflow");
}

ZTEST(atomic, test_atomic_bit_ops)
{
    pouch_atomic_t val = POUCH_ATOMIC_INIT(0);

    pouch_atomic_set_bit(&val, 3);
    zassert_true(pouch_atomic_test_bit(&val, 3), "Bit 3 should be set");

    zassert_false(pouch_atomic_test_and_clear_bit(&val, 3) == false,
                  "Bit 3 should be cleared and was set");
    zassert_false(pouch_atomic_test_bit(&val, 3), "Bit 3 should be cleared");

    zassert_false(pouch_atomic_test_and_set_bit(&val, 2), "Bit 2 should not be set before");
    zassert_true(pouch_atomic_test_bit(&val, 2), "Bit 2 should be set now");
}

ZTEST(atomic, test_atomic_bit_array_spanning)
{
    // Define enough bits to span at least 3 underlying pouch_atomic_t elements
    const int total_bits = POUCH_ATOMIC_BITS * 3;
    POUCH_ATOMIC_DEFINE(large_mask, total_bits);

    // Clear all bits
    for (int i = 0; i < total_bits; i++)
        pouch_atomic_clear_bit(large_mask, i);

    // Set a bit at the boundary of the second element
    int target_bit = POUCH_ATOMIC_BITS + 5;
    pouch_atomic_set_bit(large_mask, target_bit);

    zassert_true(pouch_atomic_test_bit(large_mask, target_bit));
    zassert_false(pouch_atomic_test_bit(large_mask, target_bit - 1));
    zassert_false(pouch_atomic_test_bit(large_mask, target_bit + 1));
}

ZTEST_SUITE(atomic, NULL, NULL, NULL, NULL, NULL);
```

## src/test_delayable_work.c
```c
/*
 * Copyright (c) 2026 Golioth, Inc.
 *
 * SPDX-License-Identifier: Apache-2.0
 */

#include <zephyr/ztest.h>
#include <zephyr/kernel.h>
#include <pouch/port.h>

struct test_work_ctx
{
    pouch_work_delayable_t dwork;
    volatile int call_count;
};

static void test_handler(pouch_work_delayable_t *dwork)
{
    struct test_work_ctx *ctx = CONTAINER_OF(dwork, struct test_work_ctx, dwork);
    ctx->call_count++;
}

ZTEST(delayable_work, test_delayable_work_init)
{
    static struct test_work_ctx ctx = {.call_count = 0};

    pouch_work_delayable_init(&ctx.dwork, test_handler);

    /* Init should not invoke the handler */
    zassert_equal(ctx.call_count, 0, "Handler should not be called on init");
}

ZTEST(delayable_work, test_delayable_work_schedule_no_wait)
{
    static struct test_work_ctx ctx = {.call_count = 0};

    pouch_work_delayable_init(&ctx.dwork, test_handler);

    int ret = pouch_work_schedule(&ctx.dwork, POUCH_NO_WAIT);
    zassert_equal(ret, 0, "pouch_work_schedule failed");

    /* Give the system workqueue time to process */
    k_sleep(K_MSEC(10));

    zassert_equal(ctx.call_count, 1, "Handler should have been called once");
}

ZTEST(delayable_work, test_delayable_work_schedule_delayed)
{
    static struct test_work_ctx ctx = {.call_count = 0};

    pouch_work_delayable_init(&ctx.dwork, test_handler);

    int ret = pouch_work_schedule(&ctx.dwork, POUCH_MSEC(50));
    zassert_equal(ret, 0, "pouch_work_schedule failed");

    /* Should not have fired yet */
    k_sleep(K_MSEC(10));
    zassert_equal(ctx.call_count, 0, "Handler should not be called before delay expires");

    /* Wait for it to fire */
    k_sleep(K_MSEC(60));
    zassert_equal(ctx.call_count, 1, "Handler should have been called after delay");
}

ZTEST(delayable_work, test_delayable_work_reschedule)
{
    static struct test_work_ctx ctx = {.call_count = 0};

    pouch_work_delayable_init(&ctx.dwork, test_handler);

    /* Schedule with a long delay */
    int ret = pouch_work_schedule(&ctx.dwork, POUCH_MSEC(500));
    zassert_equal(ret, 0, "pouch_work_schedule failed");

    /* Reschedule with no wait - should cancel the long delay and fire immediately */
    ret = pouch_work_reschedule(&ctx.dwork, POUCH_NO_WAIT);
    zassert_equal(ret, 0, "pouch_work_reschedule failed");

    k_sleep(K_MSEC(10));
    zassert_equal(ctx.call_count, 1, "Handler should have been called after reschedule");
}

ZTEST(delayable_work, test_delayable_work_cancel)
{
    static struct test_work_ctx ctx = {.call_count = 0};

    pouch_work_delayable_init(&ctx.dwork, test_handler);

    int ret = pouch_work_schedule(&ctx.dwork, POUCH_MSEC(30));
    zassert_equal(ret, 0, "pouch_work_schedule failed");

    /* Cancel before it fires */
    pouch_work_cancel_delayable(&ctx.dwork);

    /* Sleep past the original delay */
    k_sleep(K_MSEC(60));
    zassert_equal(ctx.call_count, 0, "Handler should not be called after cancel");
}

ZTEST(delayable_work, test_delayable_work_schedule_multiple)
{
    static struct test_work_ctx ctx = {.call_count = 0};

    pouch_work_delayable_init(&ctx.dwork, test_handler);

    /* Schedule twice before it fires */
    int ret = pouch_work_schedule(&ctx.dwork, POUCH_MSEC(30));
    zassert_equal(ret, 0, "first pouch_work_schedule failed");

    ret = pouch_work_schedule(&ctx.dwork, POUCH_MSEC(30));
    zassert_equal(ret, 0, "second pouch_work_schedule failed");

    /* Wait for it to fire */
    k_sleep(K_MSEC(60));
    zassert_equal(ctx.call_count, 1, "Handler should be called exactly once");
}

ZTEST_SUITE(delayable_work, NULL, NULL, NULL, NULL, NULL);
```

## src/test_semaphore.c
```c
#include <zephyr/ztest.h>
#include <pouch/port.h>

#define SEM_INIT_COUNT 1
#define SEM_LIMIT 2

POUCH_SEM_DEFINE(static_sem, 0, 1);

ZTEST(semaphore_api, test_sem_init_give_take)
{
    pouch_sem_t sem;
    int ret;

    /* Initialize semaphore */
    ret = pouch_sem_init(&sem, SEM_INIT_COUNT, SEM_LIMIT);
    zassert_equal(ret, 0, "pouch_sem_init failed");

    /* Take should succeed (count goes from 1 to 0) */
    ret = pouch_sem_take(&sem, POUCH_NO_WAIT);
    zassert_equal(ret, 0, "pouch_sem_take failed");

    /* Take again should fail (count is 0) */
    ret = pouch_sem_take(&sem, POUCH_NO_WAIT);
    zassert_not_equal(ret, 0, "pouch_sem_take should fail when count is 0");

    /* Give should increment count */
    pouch_sem_give(&sem);

    /* Take should succeed again */
    ret = pouch_sem_take(&sem, POUCH_NO_WAIT);
    zassert_equal(ret, 0, "pouch_sem_take after give failed");
}

ZTEST(semaphore_api, test_sem_reset)
{
    pouch_sem_t sem;
    int ret;

    ret = pouch_sem_init(&sem, 0, SEM_LIMIT);
    zassert_equal(ret, 0, "pouch_sem_init failed");

    /* Give to increment count */
    pouch_sem_give(&sem);

    /* Reset should set count to 0 */
    pouch_sem_reset(&sem);

    /* Take should fail (count is 0) */
    ret = pouch_sem_take(&sem, POUCH_NO_WAIT);
    zassert_not_equal(ret, 0, "pouch_sem_take should fail after reset");
}

ZTEST(semaphore_api, test_sem_static_define)
{
    int ret;

    /* Give to increment count from 0 to 1 */
    pouch_sem_give(&static_sem);

    /* Take should succeed (count goes from 1 to 0) */
    ret = pouch_sem_take(&static_sem, POUCH_NO_WAIT);
    zassert_equal(ret, 0, "pouch_sem_take failed");

    /* Take again should fail (count is 0) */
    ret = pouch_sem_take(&static_sem, POUCH_NO_WAIT);
    zassert_not_equal(ret, 0, "pouch_sem_take should fail when count is 0");
}

ZTEST_SUITE(semaphore_api, NULL, NULL, NULL, NULL, NULL);
```
