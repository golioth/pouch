## port/zephyr/Kconfig
```kconfig
# Copyright (c) 2025 Golioth, Inc.
#
# SPDX-License-Identifier: Apache-2.0

menuconfig POUCH
  bool "Golioth Pouch protocol"
  select ZCBOR
  select ZCBOR_CANONICAL
  select MBEDTLS
  select MBEDTLS_PSA_CRYPTO_C
  select PSA_WANT_ALG_SHA_256
  help
    Pouch is a protocol for communicating with Golioth from devices not
    directly connected to the internet.

# Port-specific log-level constants
rsource "Kconfig.port_log_levels"

if POUCH

# Pouch common
rsource "../../src/Kconfig"

choice
  prompt "Pouch uplink encryption scheme"
  help
    Select the encryption method to use for uplink Pouch transfers.

config POUCH_ENCRYPTION_SAEAD
  bool "Streaming AEAD"
  select PSA_WANT_ALG_ECDSA
  select PSA_WANT_ALG_ECDH
  select PSA_WANT_ALG_HKDF
  select PSA_WANT_ALG_HMAC
  select PSA_WANT_ALG_STREAM_CIPHER
  select PSA_WANT_ALG_SHA_256
  select PSA_WANT_ALG_SHA_384
  select PSA_WANT_ECC_SECP_R1_256
  select PSA_WANT_ECC_SECP_R1_384
  select PSA_WANT_KEY_TYPE_ECC_KEY_PAIR_DERIVE
  select PSA_WANT_KEY_TYPE_ECC_PUBLIC_KEY
  select MBEDTLS_ECDSA_C
  select MBEDTLS_ECP_C
  # nRF Connect SDK only:
  select NORDIC_SECURITY_BACKEND
  select MBEDTLS_PK_PARSE_C
  select MBEDTLS_PK_C
  select MBEDTLS_X509_LIBRARY
  select MBEDTLS_X509_CRT_PARSE_C
  help
    Use a streaming AEAD encryption scheme for uplink Pouch transfers.

config POUCH_ENCRYPTION_NONE
  bool "Plaintext"
  help
    No encryption.

endchoice

menu "Streaming AEAD encryption"
  depends on POUCH_ENCRYPTION_SAEAD

choice
  prompt "Encryption algorithm"
  help
    Select the encryption algorithm to use for Pouch.
    This will be used for both uplink and downlink transfers.

config POUCH_ENCRYPTION_CHACHA20_POLY1305
  bool "ChaCha20-Poly1305"
  select PSA_WANT_ALG_CHACHA20_POLY1305
  select PSA_WANT_KEY_TYPE_CHACHA20
  help
    Support ChaCha20-Poly1305 for encryption and decryption.

config POUCH_ENCRYPTION_AES_GCM
  bool "AES-GCM"
  select PSA_WANT_ALG_GCM
  select PSA_WANT_KEY_TYPE_AES
  help
    Support AES-GCM for encryption and decryption.

endchoice

config POUCH_SERVER_CERT_MAX_LEN
  int "Server certificate maximum length"
  default 4096
  help
    Maximum length of server certificate.

menuconfig POUCH_VALIDATE_SERVER_CERT
  bool "Validate server's certificate"
  default y
  help
    Disabling this will disable the server certificate validation.
    This should never be disabled in production.

config POUCH_SERVER_CERT_CN
  string "Server certificate common name"
  default "$(CONFIG_POUCH_SERVER_CERT_CN)" if "$(CONFIG_POUCH_SERVER_CERT_CN)" != ""
  default "pouch.golioth.io"
  help
    The expected common name or subject alternative name for the
    server leaf certificate.

if POUCH_VALIDATE_SERVER_CERT

config POUCH_CA_CERT_FILENAME
  string "CA certificate filename"
  default "src/goliothrootx1.der"
  help
    The filename of the CA certificate to use for Pouch.
    This is used to verify the server's identity.

endif

config MBEDTLS_USER_CONFIG_ENABLE
  default y

config MBEDTLS_USER_CONFIG_FILE
  default "$(ZEPHYR_POUCH_MODULE_DIR)/src/saead/mbedtls_config.h"

# Saead common
rsource "../../src/saead/Kconfig"

endmenu

# Transport choices
rsource "transport/Kconfig"

endif

# Gateway
rsource "../../src/gateway/Kconfig"

# Libraries
rsource "../../Kconfig"

# Golioth SDK
rsource "../../golioth_sdk/Kconfig"
```

## port/zephyr/Kconfig.port_log_levels
```kconfig
# Copyright (c) 2026 Golioth, Inc.
#
# SPDX-License-Identifier: Apache-2.0

config POUCH_LOG_LEVEL_NONE
    int
    default 0   # LOG_LEVEL_NONE

config POUCH_LOG_LEVEL_ERR
    int
    default 1   # LOG_LEVEL_ERR

config POUCH_LOG_LEVEL_WRN
    int
    default 2   # LOG_LEVEL_WRN

config POUCH_LOG_LEVEL_INF
    int
    default 3   # LOG_LEVEL_INF

config POUCH_LOG_LEVEL_DBG
    int
    default 4   # LOG_LEVEL_DBG

config POUCH_LOG_LEVEL_VERBOSE
    int
    default 4   # LOG_LEVEL_DBG

config POUCH_LOG_DEFAULT_LEVEL
    int
    default POUCH_LOG_LEVEL_NONE if !LOG
    default LOG_DEFAULT_LEVEL
```

## port/zephyr/transport/Kconfig
```kconfig
# Copyright (c) 2026 Golioth, Inc.
#
# SPDX-License-Identifier: Apache-2.0

menu "Pouch Transport"

choice POUCH_TRANSPORT
  default POUCH_TRANSPORT_SERIAL if POUCH_TRANSPORT_SERIAL_BROKER
  default POUCH_TRANSPORT_BLE_GATT if BT

config POUCH_TRANSPORT_BLE_GATT
  bool "BLE GATT"
  depends on BT
  select BT_GATT_DYNAMIC_DB
  select POUCH_TRANSPORT_SAR
  help
    BLE GATT transport for Pouch

config POUCH_TRANSPORT_HTTP_CLIENT
  bool "HTTP"
  depends on POUCH
  imply HTTP_CLIENT
  select EVENTS
  select NET_CONNECTION_MANAGER
  help
    HTTP transport for Pouch

config POUCH_TRANSPORT_COAP_CLIENT
  bool "CoAP"
  depends on POUCH
  select COAP
  select NET_SOCKETS_SOCKOPT_TLS
  select NET_SOCKETS_ENABLE_DTLS
  help
    CoAP/DTLS transport for Pouch

config POUCH_TRANSPORT_SERIAL
  bool "Serial"
  help
    Serial transport for Pouch. Implements the core serial transport,
    running on top of a serial transport adapter.

endchoice

rsource "../../../src/transport/Kconfig"

rsource "gatt/Kconfig"
rsource "http/Kconfig"
rsource "coap/Kconfig"
rsource "serial/Kconfig"

module = POUCH_TRANSPORT
module-str = Pouch Transport
source "subsys/logging/Kconfig.template.log_config"

endmenu # Pouch Transport
```

## port/zephyr/transport/coap/Kconfig
```kconfig
# Copyright (c) 2026 Golioth, Inc.
#
# SPDX-License-Identifier: Apache-2.0


menu "CoAP Transport Options"
    visible if POUCH_TRANSPORT_COAP_CLIENT

config POUCH_COAP_GW_URI
    string "CoAP gateway address"
    default "$(CONFIG_POUCH_COAP_GW_URI)" if "$(CONFIG_POUCH_COAP_GW_URI)" != ""
    default "coap.golioth.io"
    help
      URI address of the CoAP gateway.

config POUCH_COAP_GW_PORT
    string "CoAP gateway port"
    default "5684"
    help
      Port to use for the CoAP gateway.

config POUCH_COAP_REQUEST_TIMEOUT_S
    int "CoAP request timeout (seconds)"
    default 300
    help
      Timeout for individual CoAP requests.

config POUCH_COAP_BLOCK_SIZE
    int "CoAP block size for blockwise transfers"
    default 1024
    range 64 1024
    help
      CoAP block size used for blockwise transfers (Block1/Block2).
      Possible values: 64, 128, 256, 512, 1024.

config POUCH_GATEWAY_CLOUD_TRANSPORT_COAP
    bool "Use Pouch CoAP transport as the gateway cloud forwarder"
    default y
    depends on POUCH_GATEWAY && POUCH_TRANSPORT_COAP_CLIENT
    help
      Builds the CoAP implementation of the gateway cloud transport
      vtable (see <pouch/gateway/cloud.h>). The application registers
      it by calling pouch_coap_gateway_init().

module = POUCH_COAP_CLIENT
module-str = Pouch CoAP Client
source "subsys/logging/Kconfig.template.log_config"

endmenu # "CoAP Transport Options"
```

## port/zephyr/transport/gatt/Kconfig
```kconfig
# Copyright (c) 2025 Golioth, Inc.
#
# SPDX-License-Identifier: Apache-2.0

menu "Pouch BLE GATT Transport"
    visible if POUCH_TRANSPORT_BLE_GATT

config POUCH_TRANSPORT_GATT_CUD_ATTRIBUTES
    bool "Include CUD attributes for each characteristic"
    help
        If enabled, Characteristic User Description attributes will
        be added for each characteristic with a brief identifier. This
        can be useful during debugging and development to identify
        the characteristics without consulting their UUIDs.

choice POUCH_TRANSPORT_GATT_PERM
	bool "GATT permissions"

config POUCH_TRANSPORT_GATT_PERM_LESC
	bool "Require LE Secure Connection for access"

config POUCH_TRANSPORT_GATT_PERM_AUTHEN
	bool "Require authentication for access"

endchoice # POUCH_TRANSPORT_GATT_PERM


config POUCH_TRANSPORT_GATT_WINDOW_SIZE
    int "Receiver window size"
    range 1 127
    default 4
    help
        The number of unacknowledged packets that can be received by
        the device. Larger numbers can increase throughput but will
        use more RAM.


module = POUCH_GATT
module-str = Pouch GATT
source "subsys/logging/Kconfig.template.log_config"

endmenu
```

## src/Kconfig
```kconfig
# Copyright (c) 2026 Golioth, Inc.
#
# SPDX-License-Identifier: Apache-2.0

config POUCH_BLOCK_SIZE
  int "Block size"
  default 512
  help
    The maximum block size to use for Pouch transfers.

config POUCH_BLOCK_COUNT
  int "Block count"
  default 2
  range 2 10000
  help
    Number of blocks that are allocated for assembling pouch packets.

config POUCH_THREAD_STACK_SIZE
  int "Pouch thread stack size"
  default 2048
  help
    The size of the stack for the internal Pouch thread.

config POUCH_THREAD_PRIORITY
  int "Pouch thread priority"
  default 5
  help
    The priority of the internal Pouch thread.

config POUCH_EVENT_QUEUE_DEPTH
  int "Maximum pending pouch events"
  default 4
  help
    The maximum number of Pouch events that can queued to send to
    the application.

config POUCH_UPLINK_PROCESSING_STACK_SIZE
  int "Pouch uplink processing stack size"
  default 2048
  help
    The size of the stack for the internal Pouch uplink processing work
    queue.

config POUCH_UPLINK_PROCESSING_PRIORITY
  int "Pouch uplink processing thread priority"
  default 5
  help
    The priority of the internal Pouch uplink processing work queue.

config POUCH_AUTH_TAG_LEN
  int
  default 16 if POUCH_ENCRYPTION_SAEAD
  default 0

# Use POUCH_COMMON over POUCH to avoid collision with port log levels
module = POUCH_COMMON
module-str = Pouch
rsource "Kconfig.template.pouch_log_config"
```

## src/Kconfig.template.pouch_log_config
```kconfig
# SPDX-License-Identifier: Apache-2.0
#
# Based on Zephyr's Kconfig.template.log_config:
# https://github.com/zephyrproject-rtos/zephyr/blob/v4.3.0/subsys/logging/Kconfig.template.log_config

# Example usage in a Kconfig file:
#
#   module = MY_MODULE_NAME
#   module-str = My Module Name
#   rsource "path_to_pouch/src/Kconfig.template.pouch_log_config"
#

choice "$(module)_LOG_LEVEL_CHOICE"
	prompt "Max compiled-in log level for $(module-str)"
	default $(module)_LOG_LEVEL_DEFAULT

config $(module)_LOG_LEVEL_OFF
	bool "Off"

config $(module)_LOG_LEVEL_ERR
	bool "Error"

config $(module)_LOG_LEVEL_WRN
	bool "Warning"

config $(module)_LOG_LEVEL_INF
	bool "Info"

config $(module)_LOG_LEVEL_DBG
	bool "Debug"

config $(module)_LOG_LEVEL_VERBOSE
	bool "Verbose"

config $(module)_LOG_LEVEL_DEFAULT
	bool "Default"

endchoice

config $(module)_LOG_LEVEL
	int
	default POUCH_LOG_LEVEL_NONE if $(module)_LOG_LEVEL_OFF
	default POUCH_LOG_LEVEL_ERR if $(module)_LOG_LEVEL_ERR
	default POUCH_LOG_LEVEL_WRN if $(module)_LOG_LEVEL_WRN
	default POUCH_LOG_LEVEL_INF if $(module)_LOG_LEVEL_INF
	default POUCH_LOG_LEVEL_DBG if $(module)_LOG_LEVEL_DBG
	default POUCH_LOG_LEVEL_VERBOSE if $(module)_LOG_LEVEL_VERBOSE
	default POUCH_LOG_DEFAULT_LEVEL if $(module)_LOG_LEVEL_DEFAULT
```

## src/gateway/Kconfig
```kconfig
menuconfig POUCH_GATEWAY
    bool "Pouch Gateway"

if POUCH_GATEWAY

config POUCH_GATEWAY_NUM_BLOCKS
    int "Number of blocks in downlink/uplink buffer"
    default 10
    help
      The number of blocks available for buffering uplink or downlink
      data between a node device and the cloud. Each block is equal
      to CONFIG_GOLIOTH_BLOCKWISE_UPLOAD_MAX_BLOCK_SIZE in length.

config POUCH_GATEWAY_DEVICE_CERT_MAX_LEN
    int "Device certificate maximum length"
    default 1024
    help
      Maximum length of device certificate.

config POUCH_GATEWAY_SERVER_CERT_MAX_LEN
    int "Server certificate maximum length"
    default 4096
    help
      Maximum length of server certificate.

config POUCH_GATEWAY_SERVER_CERT_PEM
    string "Server certificate PEM file"
    default "server-prod.pem"
    help
        Location of the CoAP server certificate in PEM format. Path
        may be absolute or relative to the Pouch gateway `src/gateway`
        directory.

config POUCH_GATEWAY_DOWNLINK_BLOCK_TIMEOUT
    int "Downlink timeout"
    default 10
    help
      The time in seconds that the downlink module will wait for a
      block to become available in the buffer. This should be larger
      than the duration it takes to send one block to the node device.

config POUCH_GATEWAY_CLOUD
    bool "Send pouches to cloud"
    default y

config POUCH_GATEWAY_SERVER_CERT_BUILTIN
    bool
    default y if !POUCH_GATEWAY_CLOUD

module = POUCH_GATEWAY
module-str = Pouch Gateway Library
source "subsys/logging/Kconfig.template.log_config"

menu "Gateway Pouch Transport"

menuconfig POUCH_GATEWAY_GATT
    bool "BLE GATT broker transport"
    depends on BT
    select POUCH_TRANSPORT_SAR
    default y
    help
      Enable the BLE GATT broker transport for the Pouch gateway.
      This builds the GATT central/broker side, including scanning,
      discovery, and bonding support.

if POUCH_GATEWAY_GATT

config POUCH_GATT_WINDOW_SIZE
    int "GATT Window Size"
    range 1 127
    default 3
    help
        The number of unacknowledged packets that can be received by
        the device. Larger numbers can increase throughput but will
        use more RAM.

config POUCH_GATEWAY_GATT_SCAN_FILTER_BONDED
    bool "Scan filter by bonded status"
    help
      Filter scanned devices by bonded status. Use it for
      authenticated connections, so that discovered devices will be
      ignored when not bonded already. Bonding can be triggered
      explicitly by calling pouch_gateway_bonding_enable() API.

module = POUCH_GATEWAY_GATT
module-str = Pouch Gateway GATT Library
source "subsys/logging/Kconfig.template.log_config"

endif # POUCH_GATEWAY_GATT

config POUCH_TRANSPORT_SERIAL
    bool

config POUCH_TRANSPORT_SERIAL_BROKER
    bool "Serial transport"
    help
      Enable the Pouch Serial transport. This transport can be
      used in a gateway application that communicates with a
      node device over a serial connection.

module = POUCH_TRANSPORT
module-str = Pouch Transport
source "subsys/logging/Kconfig.template.log_config"

endmenu # Gateway Pouch Transport

endif # POUCH_GATEWAY
```

## src/saead/Kconfig
```kconfig
config POUCH_SERVER_CERT_MAX_LEN
  int "Server certificate maximum length"
  default 4096
  help
    Maximum length of server certificate.

menuconfig POUCH_VALIDATE_SERVER_CERT
  bool "Validate server's certificate"
  default y
  help
    Disabling this will disable the server certificate validation.
    This should never be disabled in production.

config POUCH_SERVER_CERT_CN
  string "Server certificate common name"
  default "pouch.golioth.io"
  help
    The expected common name or subject alternative name for the
    server leaf certificate.

if POUCH_VALIDATE_SERVER_CERT

config POUCH_CA_CERT_FILENAME
  string "CA certificate filename"
  default "src/goliothrootx1.der"
  help
    The filename of the CA certificate to use for Pouch.
    This is used to verify the server's identity.

endif
```

## src/transport/coap/Kconfig
```kconfig
# Copyright (c) 2025 Golioth, Inc.
#
# SPDX-License-Identifier: Apache-2.0

module = POUCH_COAP
module-str = Pouch CoAP
source "subsys/logging/Kconfig.template.log_config"
```
