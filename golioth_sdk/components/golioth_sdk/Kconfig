## golioth_sdk/components/golioth_sdk/Kconfig
```kconfig
# Copyright (c) 2026 Golioth, Inc.
#
# SPDX-License-Identifier: Apache-2.0

rsource "../../Kconfig"
```

## lib/pouch_ble_gatt_common/Kconfig
```kconfig
config POUCH_TRANSPORT_BLE_GATT_COMMON
    bool "Pouch BLE GATT transport common library"
```

## lib/pouch_gatt_common/Kconfig
```kconfig
# Copyright (c) 2025 Golioth, Inc.
#
# SPDX-License-Identifier: Apache-2.0

config POUCH_TRANSPORT_GATT_COMMON
    bool "Pouch BLE GATT transport common library"

if POUCH_TRANSPORT_GATT_COMMON

config POUCH_GATT_ACK_TIMEOUT_MS
    int "Pouch GATT ACK timeout (ms)"
    default 1000
    help
    The timeout, in milliseconds, that a receiver will wait
    for new packets before retransmitting an acknowledgement

config POUCH_GATT_COMMON_LOG_LEVEL
    int "Pouch GATT Common Log Level"
    default 3
endif # POUCH_TRANSPORT_GATT_COMMON
```

## lib/zcbor_utils/Kconfig
```kconfig
# Copyright (c) 2025 Golioth, Inc.
#
# SPDX-License-Identifier: Apache-2.0

config ZCBOR_UTILS
    bool "Helper functions for interacting with CBOR maps"
    depends on ZCBOR
```

## port/esp_idf/Kconfig
```kconfig
# Copyright (c) 2026 Golioth, Inc.
#
# SPDX-License-Identifier: Apache-2.0

menu "Pouch"

menuconfig POUCH
  bool "Golioth Pouch protocol"
  select ZCBOR
  select ZCBOR_CANONICAL
  help
    Pouch is a protocol for communicating with Golioth from devices not
    directly connected to the internet.

# Port-specific log-level constants
rsource "Kconfig.port_log_levels"

if POUCH

# Pouch
rsource "../../src/Kconfig"

choice
  prompt "Pouch uplink encryption scheme"
  help
    Select the encryption method to use for uplink Pouch transfers.

config POUCH_ENCRYPTION_SAEAD
  bool "Streaming AEAD"
  select MBEDTLS_ECDSA_C
  select MBEDTLS_ECP_C
  select MBEDTLS_HKDF_C
  help
    Use a streaming AEAD encryption scheme for uplink Pouch transfers.

config POUCH_ENCRYPTION_NONE
  bool "Plaintext"
  help
    No encryption.

endchoice

menu "Streaming AEAD encryption"
  depends on POUCH_ENCRYPTION_SAEAD

choice
  prompt "Encryption algorithm"
  help
    Select the encryption algorithm to use for Pouch.
    This will be used for both uplink and downlink transfers.

config POUCH_ENCRYPTION_CHACHA20_POLY1305
  bool "ChaCha20-Poly1305"
  select MBEDTLS_CHACHA20_C
  select MBEDTLS_CHACHAPOLY_C
  select MBEDTLS_POLY1305_C
  help
    Support ChaCha20-Poly1305 for encryption and decryption.

config POUCH_ENCRYPTION_AES_GCM
  bool "AES-GCM"
  select MBEDTLS_GCM_C
  select MBEDTLS_AES_C
  help
    Support AES-GCM for encryption and decryption.

endchoice

# Pouch sources
rsource "../../src/saead/Kconfig"

endmenu

# Transport choices
rsource "transport/Kconfig"

endif

config POUCH_FREERTOS_WORK_Q_SIZE
    int "Work queue size"
    default 10
    help
        Maximum number of pouch_work_t pointers that may be added to a
        work queue. When this limit is reached,
        pouch_work_submit_to_queue() will return an error code until a
        work item is processed and removed from the queue.

config POUCH_DELAYABLE_WORK
    bool "Delayable work support"
    default y if POUCH_TRANSPORT_BLE_GATT
    help
        Enable the dedicated delayable work thread (pouch_dwork).
        This is required by transports that use the SAR receiver,
        such as the BLE GATT transport.

if POUCH_DELAYABLE_WORK

config POUCH_DELAYABLE_WORK_STACK_SIZE
    int "Delayable work thread stack size"
    default 2048
    help
        Stack size for the dedicated delayable work thread (pouch_dwork).
        This thread executes delayed work handlers such as SAR ACK
        retransmissions.

config POUCH_DELAYABLE_WORK_Q_SIZE
    int "Delayable work queue depth"
    default 8
    help
        Maximum number of delayable work items that can be pending
        execution at one time.

config POUCH_DELAYABLE_WORK_PRIORITY
    int "Delayable work thread priority"
    default 5
    help
        The priority of the dedicated delayable work thread (pouch_dwork).

endif # POUCH_DELAYABLE_WORK

# Libraries and SDK
rsource "../../Kconfig"

endmenu # Pouch
```

## port/esp_idf/Kconfig.port_log_levels
```kconfig
# Copyright (c) 2026 Golioth, Inc.
#
# SPDX-License-Identifier: Apache-2.0

config POUCH_LOG_LEVEL_NONE
    int
    default 0   # ESP_LOG_NONE

config POUCH_LOG_LEVEL_ERR
    int
    default 1   # ESP_LOG_ERROR

config POUCH_LOG_LEVEL_WRN
    int
    default 2   # ESP_LOG_WARN

config POUCH_LOG_LEVEL_INF
    int
    default 3   # ESP_LOG_INFO

config POUCH_LOG_LEVEL_DBG
    int
    default 4   # ESP_LOG_DEBUG

config POUCH_LOG_LEVEL_VERBOSE
    int
    default 5   # ESP_LOG_VERBOSE

config POUCH_LOG_DEFAULT_LEVEL
    int
    default LOG_DEFAULT_LEVEL
```

## port/esp_idf/components/pouch/Kconfig
```kconfig
# Copyright (c) 2026 Golioth, Inc.
#
# SPDX-License-Identifier: Apache-2.0

# ESP-IDF Port Kconfig will source all other Pouch Kconfig files
rsource "../../Kconfig"
```

## port/esp_idf/components/zcbor/Kconfig
```kconfig
# Copyright (c) 2022 Nordic Semiconductor ASA
# Copyright (c) 2026 Golioth, Inc.
#
# SPDX-License-Identifier: Apache-2.0
#
# Based on:
# https://github.com/zephyrproject-rtos/zephyr/blob/v4.3.0/modules/zcbor/Kconfig

config ZCBOR
	bool "zcbor CBOR library"
	help
	  zcbor CBOR encoder/decoder library

if ZCBOR

config ZCBOR_CANONICAL
	bool "Produce canonical CBOR"
	help
	  Enabling this will prevent zcbor from creating lists and maps with
	  indefinite-length arrays.
	  Enabling this also enables the state->constant_state->enforce_canonical
	  flag in all zcbor states. This flag controls validation of canonical
	  data when decoding. If you only want canonical encoding, please set
	  the enforce_canonical flag to false in all new state structs after
	  initialization.

config ZCBOR_STOP_ON_ERROR
	bool "Stop on error when processing (Must also be enabled in state var)"
	help
	  Make the stop_on_error functionality available. Note that it still
	  needs to be enabled in the state variable
	  (`state->constant_state->stop_on_error`).
	  This makes all functions abort their execution if called when an error
	  has already happened.

config ZCBOR_VERBOSE
	bool "Make zcbor code print messages via printf"

config ZCBOR_MAX_STR_LEN
	int "Default max length when calling zcbor_tstr_put_term()"
	default 256
	help
	  This can be manually used if no other value is readily available, but
	  using this is discouraged.

endif # ZCBOR
```

## port/esp_idf/test/http_client/main/Kconfig.http_client
```kconfig
# Copyright (c) 2026 Golioth, Inc.
#
# SPDX-License-Identifier: Apache-2.0

menu "HTTP Transport Options"
    visible if POUCH_TRANSPORT_HTTP_CLIENT

config POUCH_HTTP_GW_URI
    string "Pouch gateway address"
    default "$(CONFIG_POUCH_HTTP_GW_URI)" if "$(CONFIG_POUCH_HTTP_GW_URI)" != ""
    default "gw.golioth.io"
    help
        URI address of the HTTP gateway

config POUCH_HTTP_GW_PORT
    int "Pouch gateway port"
    default 443
    help
        Port to use for the HTTP gateway

config POUCH_HTTP_TIMEOUT_S
    int "Pouch HTTP timeout (seconds)"
    default 120
    help
        Timeout for HTTP requests. This value must be long enough for
        the entire uplink and downlink process to complete. When using
        the OTA service, ensure this value is greater than the total
        expected download time for the OTA component.

config POUCH_HTTP_CLIENT_URL_BUF_SIZE
    int "HTTP upload scratch buffer size"
    default 64
    range 32 4096
    help
        Size of the scratch buffer used for storing chunks during uplink

config POUCH_HTTP_SCRATCH_BUF_SIZE
    int "HTTP upload scratch buffer size"
    default 1024
    range 15 65535
    help
        Size of the scratch buffer used for storing chunks during uplink

config POUCH_HTTP_SERVER_CRT_MAX_SIZE
    int "HTTP server cert storage size"
    default 4096
    help
        Amount of memory to allocate for storing the downloaded gateway certificate

module = POUCH_HTTP_CLIENT
module-str = Pouch HTTP Client
rsource "../../../../../src/Kconfig.template.pouch_log_config"

endmenu # "HTTP Transport Options"
```

## port/esp_idf/test/http_client/sdkconfig.defaults
```kconfig
CONFIG_ESP_MAIN_TASK_STACK_SIZE=5120
CONFIG_POUCH_THREAD_STACK_SIZE=4096
CONFIG_POUCH_UPLINK_PROCESSING_STACK_SIZE=3072
CONFIG_LOG_TIMESTAMP_SOURCE_SYSTEM=y

# Pouch
CONFIG_POUCH=y
CONFIG_GOLIOTH=y
CONFIG_GOLIOTH_OTA=y
CONFIG_GOLIOTH_SETTINGS=y

# Flash size
CONFIG_PARTITION_TABLE_TWO_OTA_LARGE=y
CONFIG_ESPTOOLPY_FLASHSIZE_8MB=y

# Application Version
CONFIG_APP_PROJECT_VER_FROM_CONFIG=y
CONFIG_APP_PROJECT_VER="1.0.0"
```

## port/esp_idf/transport/Kconfig
```kconfig
# Copyright (c) 2026 Golioth, Inc.
#
# SPDX-License-Identifier: Apache-2.0

choice
  prompt "Pouch transport"
  optional
  help
    Select the transport protocol that will carry Pouch

config POUCH_TRANSPORT_NONE
  bool "NONE"
  help
    No transport is selected. Useful for unit testing.

config POUCH_TRANSPORT_HTTP_CLIENT
  bool "HTTP"
  imply HTTP_CLIENT
  select EVENTS
  select NET_CONNECTION_MANAGER
  help
    HTTP transport for Pouch

config POUCH_TRANSPORT_BLE_GATT
  bool "BLE GATT"
  select POUCH_TRANSPORT_SAR
  help
    BLE GATT peripheral transport for Pouch.
    The device exposes a GATT service that a gateway
    can connect to for transferring Pouch data.

endchoice

rsource "../../../src/transport/Kconfig"

rsource "http/Kconfig"
rsource "gatt/Kconfig"
```

## port/esp_idf/transport/gatt/Kconfig
```kconfig
# Copyright (c) 2026 Golioth, Inc.
#
# SPDX-License-Identifier: Apache-2.0

menu "Pouch BLE GATT Transport"
    visible if POUCH_TRANSPORT_BLE_GATT

config POUCH_TRANSPORT_GATT_WINDOW_SIZE
    int "Receiver window size"
    range 1 127
    default 3
    help
        The number of unacknowledged packets that can be received by
        the device. Larger numbers can increase throughput but will
        use more RAM.

config POUCH_TRANSPORT_GATT_MTU_SIZE
    int "Maximum ATT MTU size"
    range 23 517
    default 517
    help
        The maximum ATT MTU size to negotiate. Larger values allow
        bigger packets per BLE transaction, improving throughput.

endmenu
```

## port/esp_idf/transport/uart/Kconfig
```kconfig
# Copyright (c) 2026 Golioth, Inc.
#
# SPDX-License-Identifier: Apache-2.0

# UART configuration shared by the device and broker adapters.
# The role-specific symbols (POUCH_TRANSPORT_SERIAL_DEVICE and
# POUCH_TRANSPORT_SERIAL_BROKER) are defined in the parent transport Kconfig.

if POUCH_UART_DEVICE || POUCH_UART_BROKER

config POUCH_UART_FRAME_SIZE
    int "UART frame size"
    default 255
    range 2 255
    help
      Maximum payload size in bytes for a single UART frame. The first
      byte of each frame carries the payload length, so the maximum
      payload is 255.

config POUCH_UART_PORT_NUM
    int "UART port number"
    default 1
    help
      ESP-IDF UART port to use (0, 1, or 2 depending on the target).

config POUCH_UART_BAUD_RATE
    int "UART baud rate"
    default 115200
    help
      Baud rate for the UART link.

config POUCH_UART_TX_PIN
    int "UART TX GPIO pin"
    default 17
    help
      GPIO pin for UART TX. Set to the pin connected to the peer's RX.

config POUCH_UART_RX_PIN
    int "UART RX GPIO pin"
    default 18
    help
      GPIO pin for UART RX. Set to the pin connected to the peer's TX.

config POUCH_UART_RX_BUFFER_SIZE
    int "UART RX buffer size"
    default 1024
    help
      Size in bytes of the ESP-IDF UART RX ring buffer.

config POUCH_UART_TX_BUFFER_SIZE
    int "UART TX buffer size"
    default 512
    help
      Size in bytes of the ESP-IDF UART TX ring buffer.

config POUCH_UART_EVENT_QUEUE_DEPTH
    int "UART event queue depth"
    default 20
    help
      Number of events the UART event queue can hold.

config POUCH_UART_TASK_STACK_SIZE
    int "UART RX task stack size"
    default 8192
    help
      Stack size in bytes for the UART RX event task.

config POUCH_UART_TASK_PRIORITY
    int "UART RX task priority"
    default 12
    help
      FreeRTOS priority for the UART RX event task.

config POUCH_UART_INTERFRAME_DELAY_MS
    int "Inter-frame delay (ms)"
    default 5
    range 0 10000
    help
      The minimum amount of time to wait between transmitted frames, in
      milliseconds. The delay should be set to provide enough time for the peer
      device to set up its RX buffers. Set to 0 to send frames back-to-back.

endif # POUCH_UART_DEVICE || POUCH_UART_BROKER

menuconfig POUCH_UART_DEVICE
    bool "Pouch UART device transport"
    depends on POUCH
    select POUCH_TRANSPORT_SERIAL
    select POUCH_TRANSPORT_SERIAL_DEVICE
    help
      Enable the UART transport adapter for the Pouch serial device
      protocol. The device runs on the node and communicates with a
      broker over a point-to-point UART link.

menuconfig POUCH_UART_BROKER
    bool "Pouch UART broker transport"
    depends on POUCH_GATEWAY
    select POUCH_TRANSPORT_SERIAL
    select POUCH_TRANSPORT_SERIAL_BROKER
    help
      Enable the UART transport adapter for the Pouch serial broker
      protocol. The broker runs on the gateway and drives the exchange
      sequence with a device over a point-to-point UART link.

      Requires Pouch gateway support.
```
